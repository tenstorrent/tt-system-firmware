## drivers/pmci/pldm/Kconfig
```kconfig
# Copyright (c) 2026 Tenstorrent AI ULC
# SPDX-License-Identifier: Apache-2.0

config PMCI_PLDM_PLATFORM
	bool "Enable PLDM Platform support"
	depends on PLDM && SENSOR_ASYNC_API
	default y
	help
	  Enable PLDM Platform command handling and PDR repository support.

config PMCI_PLDM_OEM
	bool "Enable PLDM OEM support"
	depends on PLDM
	help
	  Enable PLDM OEM support. OEM functionality must be provided by a compatible
	  device implementing the PLDM OEM handler API.

config PMCI_PLDM_BASE
	bool "Enable PLDM Base support"
	depends on PLDM
	help
	  Enable PLDM BASE support
```

## drivers/reset/Kconfig.tt_bh
```kconfig
# Copyright (c) 2024 Tenstorrent AI ULC
# SPDX-License-Identifier: Apache-2.0

config RESET_TT_BH
	bool "Tenstorrent Blackhole reset controller"
	default y
	depends on DT_HAS_TENSTORRENT_BH_RESET_ENABLED
	help
	  This option enables the Tenstorrent Blackhole reset controller.

config RESET_TT_BH_EMUL
	bool "Tenstorrent Blackhole reset controller emulation"
	default y
	depends on EMUL
	depends on DT_HAS_TENSTORRENT_BH_RESET_EMUL_ENABLED
	help
	  Software emul of the Blackhole reset controller for native_sim.
```

## drivers/sensor/Kconfig
```kconfig
#  Copyright (c) 2025 Tenstorrent AI ULC
#  SPDX-License-Identifier: Apache-2.0

if SENSOR

menu "Sensor Drivers"

# zephyr-keep-sorted-start
rsource "maxim/Kconfig"
rsource "pmbus/Kconfig"
rsource "tenstorrent/Kconfig"
# zephyr-keep-sorted-stop

endmenu

endif
```

## drivers/sensor/pmbus/Kconfig
```kconfig
# Copyright (c) 2026 Tenstorrent AI ULC
# SPDX-License-Identifier: Apache-2.0

menuconfig PMBUS_SENSOR
	bool "Generic PMBus sensor"
	default y
	depends on DT_HAS_PMBUS_SENSOR_ENABLED
	depends on SMBUS
	help
	  Enable the generic PMBus sensor driver.

if PMBUS_SENSOR

config PMBUS_SENSOR_INIT_PRIORITY
	int "PMBus sensor init priority"
	default 80
	help
	  Initialization priority for the PMBus sensor.

endif
```

## drivers/serial/Kconfig.tt_virt
```kconfig
# Copyright (c) 2024 Tenstorrent AI ULC
# SPDX-License-Identifier: Apache-2.0

config UART_TT_VIRT
	bool "Tenstorrent virtual UART driver"
	default y
	depends on DT_HAS_TENSTORRENT_VUART_ENABLED
	select SERIAL_HAS_DRIVER
	select SERIAL_SUPPORT_INTERRUPT
	help
	  Enable the Tenstorrent virtual UART driver.

config UART_TT_VIRT_INTERRUPT_INTERVAL
	int "Interval (in ms) to check UART state for fake interrupt support"
	default 100
	depends on (UART_TT_VIRT && UART_INTERRUPT_DRIVEN)
	help
	  The virtual UART driver is memory based, and lacks support for
	  hardware interrupts. Therefore we use a software timer on a set
	  interval to fake this support where required. This setting
	  allows adjusting the interval of the software timer.

config UART_TT_VIRT_TX_BLOCK
	bool "Block on a full TX buffer instead of dropping output"
	depends on UART_TT_VIRT
	help
	  By default, output written while the TX ring is full is discarded and
	  counted in tx_oflow, so the firmware never stalls without a host reader.
	  Enable this to wait for the host to drain the ring before dropping
	  output, so test logs are lossless when the host is responsive.

config UART_TT_VIRT_TX_BLOCK_TIMEOUT_MS
	int "TX buffer block timeout (in ms)"
	default 1000
	range 0 2147483647
	depends on UART_TT_VIRT_TX_BLOCK
	help
	  Maximum time to wait for the host to drain a full TX ring before
	  dropping the byte and incrementing tx_oflow.
```

## dts/bindings/dma/snps,designware-dma-arc-hs.yaml
```yaml
# Copyright (c) 2025 Tenstorrent AI ULC
# SPDX-License-Identifier: Apache-2.0

description: |
  Synopsys Designware ARC DMA Controller

  The driver supports both interrupt-driven and polling modes. When interrupts
  are provided in the device tree, the driver uses interrupt mode for better
  performance. When interrupts are not provided, the driver automatically
  falls back to polling mode using a work queue mechanism.

compatible: "snps,designware-dma-arc-hs"

include: [dma-controller.yaml, base.yaml]

properties:
  "#dma-cells":
    const: 1

  interrupts:
    description: |
      Optional interrupt for DMA transfer completion notifications.
      If not provided, the driver will operate in polling mode.

  dma-channels:
    type: int
    default: 16
    description: |
      Number of DMA channels supported by the DMA server.

  dma-descriptors:
    type: int
    default: 256
    description: |
      Number of DMA descriptors supported by the DMA server.

  max-burst-size:
    type: int
    default: 4
    description: |
      Maximum burst size supported by the DMA server.

  max-pending-transactions:
    type: int
    default: 4
    description: |
      Maximum number of pending bus transactions supported by the DMA server.

  buffer-size:
    type: int
    default: 16
    description: |
      DMA server data buffer size in word entries.

  dma-max-block-size:
    type: int
    default: 65536
    description: |
      Maximum size in bytes that can be transferred in a single block.
      This is typically limited by the hardware length register width.
      For 16-bit length register, max is 65536 (2^16) bytes.

  coherency-support:
    type: boolean
    description: |
      Enable coherency check for all L1 caches within the cluster by hardware.

  buffer-address-alignment:
    type: int
    default: 4
    description: |
      Required alignment in bytes for buffer addresses (source and destination).
      This is typically 4 bytes (32-bit word aligned) for ARC HS DMA.
```

## dts/bindings/memory-controllers/tenstorrent,mimir-gddr-tile.yaml
```yaml
# Copyright (c) 2026 Tenstorrent AI ULC
# SPDX-License-Identifier: Apache-2.0

compatible: "tenstorrent,mimir-gddr-tile"

description: |
  One Tenstorrent Mimir GDDR7 tile.

  The node's status enables or disables the tile in the GDDR bring-up.

include: base.yaml

properties:
  tile-index:
    type: int
    required: true
    description: Logical GDDR tile index (the gddr_tile_mask bit position).

  mem-filter-base:
    type: int
    required: true
    description: ITN SMN2ITN MEM-tile firewall base address.

  cce-filter-base:
    type: int
    required: true
    description: ITN SMN2ITN CCE-tile firewall base address.

  cce-cfg-filter-base:
    type: int
    required: true
    description: ITN SMN2ITN CCE-CFG-tile firewall base address.
```

## dts/bindings/memory-controllers/tenstorrent,mimir-memc.yaml
```yaml
# Copyright (c) 2026 Tenstorrent AI ULC
# SPDX-License-Identifier: Apache-2.0

compatible: "tenstorrent,mimir-memc"

description: |
  Tenstorrent Mimir GDDR7 memory controller.

  A single controller instance drives every GDDR tile on the chip. The tiles it
  brings up are referenced through mem-tiles; a referenced tile's status enables
  or disables it in the bring-up (gddr_tile_mask). There are GDDR_NUM_TILES (2)
  tiles on Mimir.

include: base.yaml

properties:
  mem-tiles:
    type: phandles
    required: true
    description: |
      The GDDR tiles this controller brings up. Each
      phandle references a tenstorrent,mimir-gddr-tile node.
```

## dts/bindings/misc/tenstorrent,arc-misc-cntl.yaml
```yaml
# Copyright (c) 2026 Tenstorrent AI ULC
# SPDX-License-Identifier: Apache-2.0

description: |
  ARC miscellaneous control register (RESET_UNIT_ARC_MISC_CNTL). Used by the
  message queue to clear software-triggered IRQ0.

compatible: "tenstorrent,arc-misc-cntl"

include: base.yaml

properties:
  reg:
    required: true
```

## dts/bindings/misc/tenstorrent,grendel-axi-filter.yaml
```yaml
# Copyright (c) 2026 Tenstorrent AI ULC
# SPDX-License-Identifier: Apache-2.0

description: Tenstorrent Grendel AXI fabric filter bank

compatible: "tenstorrent,grendel-axi-filter"

include: base.yaml

properties:
  reg:
    required: true

  entry-stride:
    type: int
    required: true
    description: Distance in bytes between adjacent filter entries.
```

## dts/bindings/misc/tenstorrent,grendel-d2d.yaml
```yaml
# Copyright (c) 2026 Tenstorrent AI ULC
# SPDX-License-Identifier: Apache-2.0

description: |
  Tenstorrent Grendel die-to-die (D2D) tile.

  Each tile contains a Rocket CPU that runs the D2D link firmware. Before the
  link can train, that firmware has to be written into the Rocket's SRAM, a
  configuration block has to be filled in for it, and the Rocket has to be
  released from reset.

  The CPU control register and the Rocket SRAM both live at fixed offsets
  inside the tile's register map, so a single reg entry describes the tile and
  the driver derives the rest.

  Chiplets differ in tile count and base address (Mimir has two, Keraunos has
  five), so these nodes belong in chiplet-specific devicetree rather than the
  shared Grendel SoC include.

compatible: "tenstorrent,grendel-d2d"

include: base.yaml

properties:
  reg:
    required: true

  dmas:
    type: phandle-array
    description: |
      Optional DMA channel used to zero the SRAM window and copy the image
      into it. Without it the driver writes both with CPU stores, which is
      correct but issues one bus transaction per word: a 64 KB window plus a
      27 KB image is around 23000 of them, and under emulation that is slow
      enough to matter. The reference bring-up uses DMA for exactly this.

  dma-names:
    description: Name for the channel in dmas. Only the first entry is used.

  sram-size:
    type: int
    default: 65536
    description: |
      Size in bytes of the SRAM belonging to this D2D tile's own Rocket core,
      which is where the D2D firmware runs. Not SMC memory. This describes the
      tile, not the image: every tile runs the same firmware, but the window it
      is loaded into is per-chiplet hardware. The whole window is zeroed before
      a load, it has to be large enough to hold the configuration block, and
      images that would not fit in it are rejected.

  bits-per-channel:
    type: int
    default: 16
    description: Link width reported to the D2D firmware.

  refclk-period-ns:
    type: int
    default: 10
    description: Reference clock period in nanoseconds.

  apb-clk-period-ps:
    type: int
    default: 1000
    description: APB clock period in picoseconds.

  pll-freq-ghz:
    type: int
    default: 4
    description: Target D2D PLL frequency in GHz.

  package-type-this-die:
    type: int
    default: 11
    description: |
      Package type code for the die this SMC runs on. 11 is the standard
      Grendel package.

  package-type-other-die:
    type: int
    default: 11
    description: Package type code for the die on the far end of the link.

  bypass-phy:
    type: boolean
    description: |
      Tell the D2D firmware to skip PHY bring-up. Required on emulation, where
      the PHY lanes are force-wired in the testbench instead of being trained.

  bypass-vreg:
    type: boolean
    description: |
      Tell the D2D firmware to skip voltage regulator bring-up. Required on
      emulation, which has no regulator model.

  disable-sideband:
    type: boolean
    description: |
      Tell the D2D firmware to skip sideband die-to-die synchronisation.
      Required on emulation, where the sideband milestones are stubbed out.
```

## dts/bindings/misc/tenstorrent,grendel-i3c-controller.yaml
```yaml
# Copyright (c) 2026 Tenstorrent AI ULC
# SPDX-License-Identifier: Apache-2.0

description: |
  Tenstorrent Grendel inter-die command controller over I3C.

  Issues commands to a tenstorrent,grendel-i3c-target on the remote die and
  waits for them to complete. The controller binds directly to the I3C target
  node that also represents the remote SMC.

compatible: "tenstorrent,grendel-i3c-controller"

include: base.yaml

properties:
  i3c-device:
    type: phandle
    required: true
    description: |
      I3C target device for the remote die this device sends commands to.
```

## dts/bindings/misc/tenstorrent,grendel-i3c-target.yaml
```yaml
# Copyright (c) 2026 Tenstorrent AI ULC
# SPDX-License-Identifier: Apache-2.0

description: |
  Tenstorrent Grendel inter-die command target over I3C.

  Registers as an I3C target and executes commands issued by the controller
  die. The command set currently covers D2D bring-up, so both ends of a D2D
  link can be loaded and started together; the D2D firmware image and its
  length header are expected to already be staged in local memory by the
  controller die over OCCP.

compatible: "tenstorrent,grendel-i3c-target"

include: base.yaml

properties:
  i3c:
    type: phandle
    required: true
    description: |
      I3C controller device to register as a target on. Must be configured
      for the target role.

  d2d:
    type: phandles
    required: true
    description: |
      Local tenstorrent,grendel-d2d devices driven by the D2D commands.
```

## dts/bindings/misc/tenstorrent,msgqueue-irqs.yaml
```yaml
# Copyright (c) 2026 Tenstorrent AI ULC
# SPDX-License-Identifier: Apache-2.0

description: Tenstorrent message queue interrupt specifiers

compatible: "tenstorrent,msgqueue-irqs"

include: base.yaml

properties:
  interrupts:
    required: true

  interrupt-names:
    required: true
```

## dts/bindings/misc/tenstorrent,msgqueue-mbox.yaml
```yaml
# Copyright (c) 2026 Tenstorrent AI ULC
# SPDX-License-Identifier: Apache-2.0

description: |
  Tenstorrent message queue mbox doorbell channel.

  Links a Grendel mbox controller channel to the portable SMC message
  queue as its inbound IRQ/doorbell. Presence of a node with this
  compatible (status okay) selects the mbox IRQ backend in msgqueue
  instead of Blackhole MSI/arc_misc.

compatible: "tenstorrent,msgqueue-mbox"

include: base.yaml

properties:
  mboxes:
    required: true

  mbox-names:
    required: true
```

## dts/bindings/misc/tenstorrent,msi-catcher.yaml
```yaml
# Copyright (c) 2026 Tenstorrent AI ULC
# SPDX-License-Identifier: Apache-2.0

description: |
  MSI catcher FIFO block. Register layout within the region:
  - offset 0: FIFO pop/push
  - offset 4: flush (read to clear)
  - offset 8: status

compatible: "tenstorrent,msi-catcher"

include: base.yaml

properties:
  reg:
    required: true
```

## dts/bindings/misc/tenstorrent,scratch-reg.yaml
```yaml
# Copyright (c) 2026 Tenstorrent AI ULC
# SPDX-License-Identifier: Apache-2.0

description: |
  Host-visible 32bit scratch register

compatible: "tenstorrent,scratch-reg"

include: base.yaml

properties:
  reg:
    required: true
```

## dts/bindings/misc/tenstorrent,tensix-err-irqs.yaml
```yaml
# Copyright (c) 2026 Tenstorrent AI ULC
# SPDX-License-Identifier: Apache-2.0

description: |
  Tenstorrent Tensix tile error interrupt groups.

  Each entry in interrupts is one ARC vector shared by 32 consecutive Tensix
  tiles (entry n covers tile indices 32n..32n+31). reg points at the matching
  block of TENSIX_ERR_INTR_STATUS words, one 32-bit word per entry, giving the
  per-tile interrupt level for that group.

compatible: "tenstorrent,tensix-err-irqs"

include: base.yaml

properties:
  reg:
    required: true

  interrupts:
    required: true
```

## dts/bindings/misc/tenstorrent,tt-occp-i3c.yaml
```yaml
# Copyright (c) 2026 Tenstorrent AI ULC
# SPDX-License-Identifier: Apache-2.0

description: Tenstorrent OCCP I3C Device

compatible: "tenstorrent,tt-occp-i3c"

include: [i3c-device.yaml]

properties:
  reg:
    required: true
    description: |
      I3C device 96-bit address as required by the I3C specification.

      The reg property has 3 elements:
      - Static address (can be 0 for dynamic assignment)
      - Upper 16-bit of Provisioned ID (manufacturer ID << 1)
      - Lower 32-bit of Provisioned ID (part ID << 16 | instance ID << 12)
```

## dts/bindings/misc/zephyr,gpio-line.yaml
```yaml
# Copyright (c) 2024 Tenstorrent AI ULC
# SPDX-License-Identifier: Apache-2.0

description: TT STM32 Gpio control

compatible: "zephyr,gpio-line"

properties:
  gpios:
    type: phandle-array
    required: true
```
