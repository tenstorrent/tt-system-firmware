## drivers/pmci/pldm/Kconfig
```kconfig
# Copyright (c) 2026 Tenstorrent AI ULC
# SPDX-License-Identifier: Apache-2.0

config PMCI_PLDM_PLATFORM
	bool "Enable PLDM Platform support"
	depends on PLDM && SENSOR_ASYNC_API
	default y
	help
	  Enable PLDM Platform command handling and PDR repository support.

config PMCI_PLDM_OEM
	bool "Enable PLDM OEM support"
	depends on PLDM
	help
	  Enable PLDM OEM support. OEM functionality must be provided by a compatible
	  device implementing the PLDM OEM handler API.

config PMCI_PLDM_BASE
	bool "Enable PLDM Base support"
	depends on PLDM
	help
	  Enable PLDM BASE support

config TT_PMCI_PLDM_SHELL
	bool "Enable PLDM OEM shell bridge"
	depends on SHELL
	depends on PMCI_PLDM_OEM
	select SHELL_BACKEND_DUMMY
	help
	  Enable an OEM PLDM command set that executes shell commands through
	  Zephyr shell APIs and returns captured output over MCTP/PLDM.
	  This is intended for bring-up and debug images.

config TT_PMCI_PLDM_MCTP_RESPONDER
	bool "Tenstorrent PLDM responder over MCTP"
	depends on DT_HAS_TENSTORRENT_PLDM_MCTP_RESPONDER_ENABLED
	depends on MCTP && PLDM && MCTP_I3C_TARGET
	select PMCI_PLDM_BASE
	select PMCI_PLDM_PLATFORM
	help
	  Enable Tenstorrent PLDM responder over an MCTP I3C target transport.
	  The driver consumes PLDM messages and emits responses for supported
	  PLDM Base and Platform commands.

config TT_PMCI_PLDM_LIBPLDM_FD
	bool "Build the libpldm firmware device responder"
	depends on PLDM
	select PLDM_ABI_TESTING
	help
	  Compile libpldm's DSP0267 firmware device responder (pldm_fd_*,
	  src/firmware_device/fd.c) and the PLDM control helper it calls
	  (src/control.c). The libpldm Zephyr module does not build them, and
	  their API is still marked testing (LIBPLDM_ABI_TESTING).

config TT_PMCI_PLDM_FW_UPDATE
	bool "PLDM firmware update (DSP0267) firmware device"
	default y
	depends on DT_HAS_TENSTORRENT_PLDM_FW_UPDATE_ENABLED
	depends on PLDM && MCUBOOT_IMG_MANAGER
	depends on $(dt_nodelabel_enabled,slot1_partition)
	select TT_PMCI_PLDM_LIBPLDM_FD
	select IMG_ERASE_PROGRESSIVELY
	help
	  Answer PLDM for Firmware Update (type 5), with the identity given by
	  the tenstorrent,pldm-fw-update devicetree node. The update agent's
	  image is written to the MCUboot secondary slot, and ActivateFirmware
	  requests a test swap. The new image runs after the next reset and
	  must confirm itself, or MCUboot reverts it. No update is accepted
	  while the running image is unconfirmed.

if TT_PMCI_PLDM_FW_UPDATE

config TT_PMCI_PLDM_FW_UPDATE_TRANSFER_SIZE
	int "Largest firmware data chunk to request"
	default 32
	range 32 1024
	help
	  libpldm never asks for less than 32 bytes. Each chunk arrives in
	  one PLDM message, so the responder must accept messages this size
	  plus 4 bytes of PLDM header and completion code.

endif # TT_PMCI_PLDM_FW_UPDATE
```

## dts/bindings/misc/tenstorrent,pldm-fw-update.yaml
```yaml
# Copyright (c) 2026 Tenstorrent AI ULC
# SPDX-License-Identifier: Apache-2.0

description: |
  PLDM for Firmware Update (DSP0267) firmware device identity.

  An update agent offers a firmware package to a device only if the package's
  descriptors match the ones the device reports, so the UUID must differ
  between boards whose images are not interchangeable.

compatible: "tenstorrent,pldm-fw-update"

include: base.yaml

properties:
  uuid:
    type: string
    required: true
    description: |
      UUID descriptor reported in QueryDeviceIdentifiers, as
      "xxxxxxxx-xxxx-xxxx-xxxx-xxxxxxxxxxxx".

  component-id:
    type: int
    default: 1
    description: |
      Component identifier of the application image, the one component
      the device updates. The default 1 suits a board with no other
      firmware component; a package names the same identifier.
```

## dts/bindings/sensor/pmbus,sensor.yaml
```yaml
# Copyright (c) 2026 Tenstorrent AI ULC
# SPDX-License-Identifier: Apache-2.0

description: Generic PMBus sensor

compatible: "pmbus,sensor"

include: [sensor-device.yaml, base.yaml]

properties:
  reg:
    required: true

  dmc_efuse:
    type: boolean
    description: |
      The device is a DMC-managed eFuse. Its telemetry format is chosen at
      runtime by MFR_SYS_CTRL bit 12 (REPORT_FORMAT), and in DIRECT format the
      READ_PIN resolution comes from DEVICE_CONFIG_00 bits 1:0 (SCALE_SEL). The
      driver reads both once at init when this is set.
```

## lib/tenstorrent/bh_arc/Kconfig
```kconfig
# Copyright (c) 2024 Tenstorrent AI ULC
# SPDX-License-Identifier: Apache-2.0

config TT_BH_ARC
	bool "Blackhole ARC firmware library"
	select FLASH
	select FLASH_PAGE_LAYOUT
	select TT_BOOT_FS
	select TT_FW_COMMON
	select NANOPB
	select CRC
	select I2C
	select I2C_TARGET
	select SMBUS_TARGET
	select ZBUS
	help
	  This option enables the Blackhole ARC firmware library.

config TT_POST_CODE
	bool
	default y if BOARD_TT_BLACKHOLE
	help
	  Enables writing firmware post codes to the status scratch register.

if TT_BH_ARC

config TT_BH_ARC_EMUL
	bool "BH ARC emulation"
	default y if BOARD_NATIVE_SIM
	select TT_FW_COMMON_EMUL
	help
	  Generic flag that BH ARC is emulated.
	  Enabled by default on native_sim and can be enabled on other
	  boards that need emulated ARC behavior.

config TT_SHELL
	bool "Tenstorrent Blackhole shell driver"
	depends on SHELL
	default y
	help
	  Enable the Tenstorrent Shell

config TT_BH_ARC_FAN_CTRL_ALPHA
	int "Fan control alpha value"
	default 50
	help
	  Value of alpha for filtering fan curve input temp

config TT_BH_ARC_FAN_CTRL_GDDR_TEMP
	bool "Use GDDR temp as fan curve input"
	default y
	help
	  Enable to use GDDR temp in fan speed calculation

config TT_BH_ARC_GDDR_CA_LATCH
	bool "Latch-and-retest flow for GDDR CA VREF settings"
	default y
	help
	  Seed MRISC with per-controller CA VREF/termination settings stored in
	  the gddrcal flash partition, enable the MRISC post-training CA margin
	  check with full-sweep fallback, and latch any updated settings back to
	  flash after training. Settings cover CA VREF offset and CA termination
	  offset, stored per ASIC and per controller. Requires gddrcal_a and
	  gddrcal_b fixed partitions in the devicetree. Requires MRISC FW with
	  params table v7 or newer; older MRISC FW ignores the extra fields.
	  With MRISC 2.18+ (params table v9) the margin check is a 2D five-point
	  check, the fallback re-centers CA on the 2D eye and searches CA
	  termination x PHY CA TX drive pairs, and the PHY CA TX drive (the CA
	  drive strength) and per-channel CA phase offsets are latched and
	  seeded as well. The DRAM OCD pulldown is not a CA setting and is left
	  at the MRISC board default. A failed first training no longer halts:
	  MRISC's CA boot rescue retrains CA candidates, CA centering starts
	  from the one that trains, and the SMC latches it like any other
	  passing point. Only a passing boot CA verdict (telemetry v4) is
	  latched.

config TT_BH_ARC_GDDR_CA_PER_CH_VREFC
	bool "Let MRISC pick a separate CA VREFC per GDDR channel"
	depends on TT_BH_ARC_GDDR_CA_LATCH
	help
	  MRISC 2.18+ 2D eye centering normally uses one CA VREFC for both
	  channels of a controller (the value that maximizes the worse
	  channel's margin). With this option it targets each channel's own
	  eye centroid, programming channel B through its PHY DRAM config
	  register, and the SMC latches and seeds channel B's VREFC separately.

config TT_BH_ARC_GDDR_CA_PHASE_LATCH_DEADBAND
	int "CA phase offset change needed to rewrite gddrcal, in 2-mixer-step units"
	depends on TT_BH_ARC_GDDR_CA_LATCH
	range 0 127
	default 6
	help
	  MRISC re-centers CA on every boot, and the phase offset it applies
	  on top of CA training varies by a few mixer steps from boot to boot
	  with the training result (std 2-3 steps over 100 boots). The saved
	  offset is only the starting point of the next boot, so it is
	  rewritten only when an applied offset differs from it by more than
	  this many 2-step units (any VREFC, termination or driver strength
	  change is always saved). The default of 12 mixer steps kept it to
	  1-2 writes per controller over 100 boots.

config TT_BH_ARC_I2C_TIMEOUT
	bool "Time out if I2C transaction exceeds given duration"
	default y
	help
	  Timeout if I2C transaction exceeds set duration. This can be useful
	  to recover from bus stalls. If the TX FIFO for the I2C controller
	  remains full for this timeout, the I2C controller will attempt to
	  recover the bus by sending 16 SCL pulses while holding SDA low.

config TT_BH_ARC_I2C_TIMEOUT_DURATION
	int "Timeout for I2C transactions in milliseconds"
	default 25
	depends on TT_BH_ARC_I2C_TIMEOUT
	help
	  Timeout for I2C transactions in milliseconds. If the TX FIFO for the I2C controller
	  remains full for this timeout, the I2C controller will attempt to recover the bus by
	  sending 16 SCL pulses while holding SDA low.

config TT_SMC_RECOVERY
	bool "build smc recovery image"
	help
	  Enable to build smc recovery image.

config TT_BH_ARC_WDT_FEED_INTERVAL
	int "Feed interval for watchdog (ms)"
	default 250
	help
	  Interval to feed watchdog within firmware

config TT_BH_ARC_SCRATCHPAD_SIZE
	int "Size of scratchpad memory in bytes"
	default 512
	help
	  Size of scratchpad memory in bytes. This is mainly used as a temporary buffer for
	  loading images from SPI flash.

config TT_BH_ARC_RUNTIME_TELEMETRY_SIZE
	int "Runtime telemetry reserved BSS size in bytes"
	default 1024
	range 0 65536
	help
	  Bytes carved from BSS for host runtime telemetry use. Must be a multiple
	  of 32. Set to 0 to disable runtime telemetry.

config TT_BH_ARC_RUNTIME_TELEMETRY
	def_bool TT_BH_ARC_RUNTIME_TELEMETRY_SIZE > 0

config TT_BH_ARC_DMFW_PING_TIMEOUT
	int "Timeout for DMFW ping in milliseconds"
	default 200
	help
	  Timeout for DMFW ping in milliseconds. If the DMFW does not respond within this time,
	  the ping will be considered failed.

module = BH_ARC
module-str = bh_arc
source "subsys/logging/Kconfig.template.log_config"

rsource "Kconfig.tt_pcie_log"

endif
```

## tests/drivers/pmci/pldm/testcase.yaml
```yaml
common:
  tags:
    - pldm
    - mctp
    - dmc
  platform_allow:
    - nucleo_u385rg_q
  integration_platforms:
    - nucleo_u385rg_q

tests:
  drivers.pldm.nucleo: {}
  drivers.pldm.nucleo.fw_update:
    extra_args:
      - EXTRA_DTC_OVERLAY_FILE=fw_update.overlay
    extra_configs:
      - CONFIG_FLASH=y
      - CONFIG_FLASH_MAP=y
      - CONFIG_STREAM_FLASH=y
      - CONFIG_IMG_MANAGER=y
      - CONFIG_MCUBOOT_IMG_MANAGER=y
```

## tests/drivers/pmci/pldm_base/testcase.yaml
```yaml
common:
  platform_allow:
    - native_sim
tests:
  drivers.pmci.pldm_base:
    tags: pmci pldm
  drivers.pmci.pldm_base.fw_update:
    tags: pmci pldm
    extra_args:
      - EXTRA_DTC_OVERLAY_FILE=fw_update.overlay
    extra_configs:
      - CONFIG_FLASH=y
      - CONFIG_FLASH_MAP=y
      - CONFIG_STREAM_FLASH=y
      - CONFIG_IMG_MANAGER=y
      - CONFIG_MCUBOOT_IMG_MANAGER=y
```

## tests/drivers/pmci/pldm_fw_update/testcase.yaml
```yaml
common:
  platform_allow:
    - native_sim
tests:
  drivers.pmci.pldm_fw_update:
    tags: pmci pldm
```

## tests/drivers/sensors/bh_arc_telem/testcase.yaml
```yaml
common:
  tags:
    - drivers
    - sensor
    - bh_arc_telem

tests:
  drivers.sensor.bh_arc_telem.native_sim:
    platform_allow:
      - native_sim
    integration_platforms:
      - native_sim
    extra_args:
      - DTC_OVERLAY_FILE=boards/native_sim.overlay
      - EXTRA_CONF_FILE=../../../../app/dmc/boards/native_sim.conf
  drivers.sensor.bh_arc_telem.native_sim.ubsan:
    platform_allow:
      - native_sim
    extra_args:
      - DTC_OVERLAY_FILE=boards/native_sim.overlay
      - EXTRA_CONF_FILE=../../../../app/dmc/boards/native_sim.conf
    extra_configs:
      # Misaligned accesses do not fault on x86: trap on them instead
      - CONFIG_UBSAN=y
      - CONFIG_UBSAN_TRAP=y
```
