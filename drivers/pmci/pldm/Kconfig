## dts/bindings/mtd/tenstorrent,flash-mux.yaml
```yaml
# Copyright (c) 2026 Tenstorrent AI ULC
# SPDX-License-Identifier: Apache-2.0

description: |
  Runtime-selected flash configuration multiplexer.

  Presents a single flash device backed by one of several candidate flash
  devices. The candidates describe the same physical flash chip under
  different configurations - one node per supported second-source part,
  distinguished by the jedec-id property, plus exactly one catch-all
  that omits jedec-id. They are the zephyr,deferred-init children of
  candidate-bus.

  At init the mux initializes the catch-all, reads the chip's JEDEC ID
  through it, and initializes the candidate whose jedec-id matches,
  falling back to the catch-all if none matches or its initialization
  fails. All flash API calls are forwarded to the selected candidate.

  Candidates sharing a bus position are distinct devices to the bus
  controller, so give their bus the software-multiperipheral property:
  the controller is then reconfigured whenever a different device
  accesses it.

compatible: "tenstorrent,flash-mux"

include: base.yaml

properties:
  candidate-bus:
    type: phandle
    required: true
    description: |
      Bus whose zephyr,deferred-init children are the candidates. They
      are not referenced directly, as a non-deferred device cannot
      depend on deferred ones.
```

## dts/bindings/mtd/tenstorrent,tt-boot-fs.yaml
```yaml
# Copyright (c) 2025 Tenstorrent AI ULC
# SPDX-License-Identifier: Apache-2.0

description: Tenstorrent Flash Partitions

include: ["fixed-partitions.yaml"]

compatible: tenstorrent,tt-boot-fs

properties:
  flash-device-size:
    type: int
    required: true
  flash-block-size:
    type: int
    required: true
  header-addr:
    type: int
    required: true
    description: |
      Base address in flash of this tt-boot-fs descriptor table (FD table),
      e.g. 0x0 for the ROM table, 0x4000 for the failover table, or 0x170000
      for the mutable table. This is the start of the descriptor table itself,
      not the multi-table bootfs header at TT_BOOT_FS_HEADER_ADDR.

child-binding:
  properties:
    binary-path:
      type: string
      description: |
        Path to the binary file to be flashed into this partition. If absent,
        the partition will not be allocated in the final image.
    provisioning-only:
      type: boolean
      description: |
        Set to indicate the partition is only provisioned during manufacturing
    source:
      type: string
      description: |
        Where to place the binary in flash memory. Can be an absolute address,
        or relative to end of flash by referencing $END. If absent, the register
        address is used to determine where the binary is placed in flash.
        If set to $AUTO, the image will be automatically placed as close to
        the start of flash as it will fit.
    padto:
      type: int
      description: |
        Pad the region the binary occupies to support fixed size tt_boot_fs entries.
    executable:
      type: boolean
      description: |
        Set to indicate the partition is executable. This is used to determine
        whether the partition should be loaded into memory and executed by the
        bootloader.
    offset:
      type: int
      description: |
        Address where the bootloader should load an executable binary within memory.
```

## dts/bindings/pcie/tenstorrent,grendel-pcie.yaml
```yaml
# Copyright (c) 2026 Tenstorrent AI ULC
# SPDX-License-Identifier: Apache-2.0

description: Tenstorrent Grendel (Keraunos) PCIe endpoint

compatible: "tenstorrent,grendel-pcie"

include: base.yaml

properties:
  reg:
    type: array
    required: true
    description: SMN window covering PCIe MGMT / DBI (lib uses fixed MMIO).

  bar4-size:
    type: array
    required: true
    description: |
      Size in bytes of the 64-bit BAR4 pair (ATU maps this to the SMC/SEP
      SPA region), two 32-bit cells (high, then low), same encoding as
      addresses in reg. Default in the SoC dtsi is 64 GiB
      (<0x10 0x0> = 0x1000000000) so QEMU accepts the BAR. Silicon will
      use the full aperture (<0x20000 0x0> = 0x2000000000000).
```

## dts/bindings/reset/tenstorrent,bh-reset-emul.yaml
```yaml
# Copyright (c) 2026 Tenstorrent AI ULC
# SPDX-License-Identifier: Apache-2.0

compatible: "tenstorrent,bh-reset-emul"

include: [base.yaml, reset-controller.yaml]

description: |
  Emulated Tenstorrent Blackhole reset controller for native_sim / twister.

  Same line-id and reset-mask / nresets / n-banks semantics as
  tenstorrent,bh-reset, but stores bank words in driver data instead of MMIO
  (no reg property).

properties:
  nresets:
    type: int
    description: |
      The number of reset lines associated with the reset controller instance.
      Contiguous from bit 0. Valid range 0 <= nresets <= 32.

  reset-mask:
    type: int
    description: |
      The bitmask of valid reset line ids for this controller instance.

  n-banks:
    type: int
    description: |
      Number of 32-bit bank words this instance emulates (default 1).
      Bank i is selected with offset = i * 4 in reset_tt_bh_lines_*.

  "#reset-cells":
    const: 1

reset-cells:
- id
```

## dts/bindings/reset/tenstorrent,bh-reset.yaml
```yaml
# Copyright (c) 2024 Tenstorrent AI ULC
# SPDX-License-Identifier: Apache-2.0

compatible: "tenstorrent,bh-reset"

include: [base.yaml, reset-controller.yaml]

description: |
  Tenstorrent Blackhole Reset Controller

  The Tenstorrent Blackhole reset controller is used to manage one bank of reset signals occupying
  a 32-bit memory-mapped address. Reset lines are active-low (bit clear asserts reset).

  There are 3 usage modes.

  1. no mask is specified - 32 reset lines are available to the reset controller instance

    resetX: reset@abcd1234 {
        compatible = "tenstorrent,bh-reset";
        reg = <0xabcd1234 0x4>;
        #reset-cells = <1>;
        status = "okay";
    };

  2. a mask is specified. Only the bits (id values) set high in the mask are valid. In the
    example below, id 1 and id 6 are valid.

    resetX: reset@abcd1234 {
        compatible = "tenstorrent,bh-reset";
        reg = <0xabcd1234 0x4>;
        #reset-cells = <1>;
        reset-mask = <0x42>;
        status = "okay";
    };

  3. a number of resets is specified. In the example below, the least-significant 3 bits are
     available to the reset controller instance. So id 0, id 1, and id 2 are valid.

    resetX: reset@abcd1234 {
        compatible = "tenstorrent,bh-reset";
        reg = <0xabcd1234 0x4>;
        #reset-cells = <1>;
        nresets = <3>;
        status = "okay";
    };

  If neither nresets, nor reset-mask is specified, then all 32 reset lines are available.

  Maximally one of nresets or reset-mask may be specified.

  Dual-field registers (eth, ddr, l2cpu) use a single node with reset-mask covering both the
  tile and RISC halves. Line IDs are physical bit indices; see
  include/zephyr/dt-bindings/reset/tt-bh-reset.h for helpers (TT_BH_ETH_TILE_ID, TT_BH_ETH_RISC_ID,
  etc.).

  Example eth_reset (tile bits [13:0], RISC bits [29:16]):

    eth_reset: reset@80030008 {
        compatible = "tenstorrent,bh-reset";
        reg = <0x80030008 0x4>;
        #reset-cells = <1>;
        reset-mask = <0x3fff3fff>;
        status = "okay";
    };


properties:
  reg:
    required: true

  nresets:
    type: int
    description: |
      The number of reset lines associated with the reset controller instance.

      This parameter is useful when the lines associated with the reset controller instance are
      contiguous, beginning at bit 0.

      I.e. for nresets = <5>, the value written to the reset register would be equivalent to
      BIT_MASK(5), or 0x1f.

      The valid range for nresets is 0 <= nresets <= 32.

  reset-mask:
    type: int
    description: |
      The bitmask of valid reset line ids for this controller instance.

      This parameter is useful when the lines associated with the reset controller instance are
      non-contiguous, or when a dual-field register exposes tile and RISC halves in one word.

      I.e. for reset-mask = <0x3fff3fff>, tile ids 0..13 and RISC ids 16..29 are valid.

  "#reset-cells":
    const: 1

reset-cells:
- id
```
