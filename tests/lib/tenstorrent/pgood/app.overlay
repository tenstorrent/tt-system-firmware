/*
 * Copyright (c) 2024 Tenstorrent AI ULC
 *
 * SPDX-License-Identifier: Apache-2.0
 */

#include <zephyr/dt-bindings/gpio/gpio.h>

/ {
	/* Emulated ASIC reset line */
	asic_reset {
		compatible = "zephyr,gpio-line";
		gpios = <&gpio0 0 GPIO_ACTIVE_LOW>;
	};

	/* Emulated power good indicator */
	pgood {
		compatible = "zephyr,gpio-line";
		gpios = <&gpio0 1 GPIO_ACTIVE_HIGH>;
	};

	/* Emulated board fault LED */
	board_fault_led {
		compatible = "zephyr,gpio-line";
		gpios = <&gpio0 2 GPIO_ACTIVE_HIGH>;
	};
};
