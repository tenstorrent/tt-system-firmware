## tests/boards/tenstorrent/tt_blackhole/clock_control/testcase.yaml
```yaml
common:
  tags:
    - drivers
    - clock_control
tests:
  drivers.clock_control.basic:
    tags: smoke
    platform_allow:
      - tt_blackhole@p100a/tt_blackhole/smc
      - tt_blackhole@p150a/tt_blackhole/smc
      - tt_blackhole@p150b/tt_blackhole/smc
      - tt_blackhole@p300a/tt_blackhole/smc
    extra_args:
      - "platform:tt_blackhole@p100a/tt_blackhole/smc:DTC_OVERLAY_FILE=\
         app.overlay"
      - "platform:tt_blackhole@p150a/tt_blackhole/smc:DTC_OVERLAY_FILE=\
         app.overlay"
      - "platform:tt_blackhole@p150b/tt_blackhole/smc:DTC_OVERLAY_FILE=\
         app.overlay"
      - "platform:tt_blackhole@p300a/tt_blackhole/smc:DTC_OVERLAY_FILE=\
         app.overlay"
```

## tests/boards/tenstorrent/tt_blackhole/ina228/testcase.yaml
```yaml
tests:
  drivers.sensor.ina228.basic:
    tags:
      - drivers
      - sensor
      - ina228
    platform_allow:
      - tt_blackhole@p100a/tt_blackhole/dmc
      - tt_blackhole@p150a/tt_blackhole/dmc
      - tt_blackhole@p150b/tt_blackhole/dmc
      - tt_blackhole@p150c/tt_blackhole/dmc
      - tt_blackhole@p300a/tt_blackhole/dmc
      - tt_blackhole@p300b/tt_blackhole/dmc
      - tt_blackhole@p300c/tt_blackhole/dmc
    extra_args:
      - "platform:tt_blackhole@p100a/tt_blackhole/dmc:CONFIG_TDP_LIMIT=100"
      - "platform:tt_blackhole@p150a/tt_blackhole/dmc:CONFIG_TDP_LIMIT=150"
      - "platform:tt_blackhole@p150b/tt_blackhole/dmc:CONFIG_TDP_LIMIT=150"
      - "platform:tt_blackhole@p150c/tt_blackhole/dmc:CONFIG_TDP_LIMIT=500"
      - "platform:tt_blackhole@p300a/tt_blackhole/dmc:CONFIG_TDP_LIMIT=86"
      - "platform:tt_blackhole@p300b/tt_blackhole/dmc:CONFIG_TDP_LIMIT=94"
      - "platform:tt_blackhole@p300c/tt_blackhole/dmc:CONFIG_TDP_LIMIT=158"
```

## tests/boards/tenstorrent/tt_blackhole/noc2axi_broadcast/testcase.yaml
```yaml
tests:
  lib.tenstorrent.bh_arc.noc2axi_broadcast:
    tags:
      - smoke
    platform_allow:
      - tt_blackhole@p100a/tt_blackhole/smc
      - tt_blackhole@p150a/tt_blackhole/smc
      - tt_blackhole@p150b/tt_blackhole/smc
      - tt_blackhole@p300a/tt_blackhole/smc
    extra_args:
      - "DTC_OVERLAY_FILE=app.overlay"
```

## tests/boards/tenstorrent/tt_blackhole/sensor/pvt/testcase.yaml
```yaml
common:
  tags:
    - drivers
    - sensor
    - pvt
tests:
  drivers.sensor.pvt.basic:
    tags: smoke
    platform_allow:
      - tt_blackhole@p100a/tt_blackhole/smc
      - tt_blackhole@p150a/tt_blackhole/smc
      - tt_blackhole@p150b/tt_blackhole/smc
      - tt_blackhole@p300a/tt_blackhole/smc
    extra_args:
      - "platform:tt_blackhole@p100a/tt_blackhole/smc:DTC_OVERLAY_FILE=\
         app.overlay"
      - "platform:tt_blackhole@p150a/tt_blackhole/smc:DTC_OVERLAY_FILE=\
         app.overlay"
      - "platform:tt_blackhole@p150b/tt_blackhole/smc:DTC_OVERLAY_FILE=\
         app.overlay"
      - "platform:tt_blackhole@p300a/tt_blackhole/smc:DTC_OVERLAY_FILE=\
         app.overlay"
```

## tests/drivers/flash/performance/testcase.yaml
```yaml
common:
  tags:
    - drivers
    - flash
tests:
  drivers.flash.performance.mt25:
    tags: smoke
    platform_allow:
      - tt_blackhole@p100a/tt_blackhole/smc
      - tt_blackhole@p150a/tt_blackhole/smc
      - tt_blackhole@p300a/tt_blackhole/smc
    extra_configs:
      # The below values are set experimentally. A test failure may
      # indicate a performance regression in the flash driver.
      - CONFIG_EXPECTED_READ_TIME=8
      - CONFIG_EXPECTED_PROGRAM_TIME=400
```

## tests/drivers/fw_table/testcase.yaml
```yaml
common:
  platform_allow:
    - native_sim
tests:
  drivers.fw_table.ccfgovr: {}
```

## tests/drivers/pmci/pldm_pdr/testcase.yaml
```yaml
common:
  platform_allow:
    - native_sim
tests:
  drivers.pmci.pldm_pdr.builder: {}
```

## tests/drivers/sensors/bh_arc_telem/testcase.yaml
```yaml
common:
  tags:
    - drivers
    - sensor
    - bh_arc_telem

tests:
  drivers.sensor.bh_arc_telem.native_sim:
    platform_allow:
      - native_sim
    integration_platforms:
      - native_sim
    extra_args:
      - DTC_OVERLAY_FILE=boards/native_sim.overlay
      - EXTRA_CONF_FILE=../../../../app/dmc/boards/native_sim.conf
```

## tests/lib/tenstorrent/bh_fwtable/testcase.yaml
```yaml
common:
  platform_allow:
    - native_sim
  tags:
    - drivers
    - bh_fwtable

tests:
  lib.tenstorrent.bh_fw_table: {}
```

## tests/lib/tenstorrent/chip_info/testcase.yaml
```yaml
tests:
  lib.tenstorrent.chip_info.recovery:
    platform_allow: native_sim
    tags: bh_arc chip_info
```
