## tests/drivers/dma/all_chan_link_transfer/Kconfig
```kconfig
# Copyright (c) 2025 Tenstorrent AI ULC
# SPDX-License-Identifier: Apache-2.0

mainmenu "DMA Link Transfer Test"

source "Kconfig.zephyr"

config DMA_NUM_CHANNELS
	int "Number of DMA channels to test"
	default 16

config DMA_LINK_ALIGNMENT
	int "TX and RX data alignment in bytes"
	default 32
```

## tests/drivers/dma/all_chan_link_transfer/testcase.yaml
```yaml
common:
  tags:
    - dma
    - smoke
  platform_allow:
    - tt_blackhole@p100a/tt_blackhole/smc
    - tt_blackhole@p150a/tt_blackhole/smc
    - tt_blackhole@p150b/tt_blackhole/smc
    - tt_blackhole@p300a/tt_blackhole/smc
tests:
  drivers.dma.all_chan_link_transfer.arc_hs.interrupts:
    extra_dtc_overlay_files:
      - arc_hs.overlay
```

## tests/drivers/dma/all_chan_scatter_gather/testcase.yaml
```yaml
common:
  tags:
    - dma
tests:
  drivers.dma.all_chan_scatter_gather.tt_mimir_smc:
    platform_allow:
      - tt_mimir/tt_mimir/smc
    extra_dtc_overlay_files:
      - tt_mimir_tt_mimir_smc.overlay
    extra_conf_files:
      - tt_mimir.conf
  drivers.dma.all_chan_scatter_gather.tt_bh_noc:
    platform_allow:
      - tt_blackhole@p100a/tt_blackhole/smc
      - tt_blackhole@p150a/tt_blackhole/smc
      - tt_blackhole@p150b/tt_blackhole/smc
      - tt_blackhole@p300a/tt_blackhole/smc
    extra_dtc_overlay_files:
      - tt_bh_noc.overlay
    extra_conf_files:
      - tt_bh_noc.conf
  drivers.dma.all_chan_scatter_gather.arc_hs.interrupts:
    platform_allow:
      - tt_blackhole@p100a/tt_blackhole/smc
      - tt_blackhole@p150a/tt_blackhole/smc
      - tt_blackhole@p150b/tt_blackhole/smc
      - tt_blackhole@p300a/tt_blackhole/smc
    extra_dtc_overlay_files:
      - arc_hs.overlay
    extra_conf_files:
      - arc_hs.conf
```

## tests/drivers/dma/arc_hs_multichannel/Kconfig
```kconfig
# Copyright (c) 2026 Tenstorrent AI ULC
# SPDX-License-Identifier: Apache-2.0

mainmenu "ARC HS multichannel DMA test"

source "Kconfig.zephyr"

config DMA_NUM_CHANNELS
	int "Number of ARC HS DMA channels to exercise concurrently"
	default 16

config DMA_MULTIGROUP_BLOCK_COUNT
	int "Chained block count to reach descriptor group 1+ (handle >= 32)"
	default 33

config DMA_BLOCK_SIZE
	int "Transfer block size in bytes"
	default 64

config DMA_BLEN_ALIGNMENT
	int "TX and RX data alignment in bytes"
	default 32
```

## tests/drivers/dma/arc_hs_multichannel/testcase.yaml
```yaml
common:
  tags:
    - smoke
    - dma
  platform_allow:
    - tt_blackhole@p100a/tt_blackhole/smc
    - tt_blackhole@p150a/tt_blackhole/smc
    - tt_blackhole@p150b/tt_blackhole/smc
    - tt_blackhole@p300a/tt_blackhole/smc
tests:
  drivers.dma.arc_hs_multichannel.arc_hs.interrupts:
    extra_dtc_overlay_files:
      - arc_hs.overlay
    extra_conf_files:
      - arc_hs.conf
```

## tests/drivers/pmci/pldm_platform/testcase.yaml
```yaml
common:
  platform_allow:
    - native_sim
tests:
  drivers.pmci.pldm_platform:
    tags: pmci pldm
```

## tests/drivers/tt_pcie/testcase.yaml
```yaml
common:
  tags:
    - drivers
tests:
  drivers.tt_pcie.endpoint:
    build_only: true
    platform_allow:
      - tt_mmk/tt_keraunos/smc
```

## tests/drivers/tt_smc_remoteproc/testcase.yaml
```yaml
common:
  tags:
    - drivers
tests:
  drivers.tt_smc_remoteproc.bl1_primary:
    tags: smoke
    platform_allow:
      - tt_mimir/tt_mimir/smc
      - tt_mmk/tt_keraunos/smc
      - tt_qsr1a1/tt_keraunos/smc
    sysbuild: true
    harness: console
    harness_config:
      type: one_line
      regex:
        - "Secondary BL1 is running on .*!"
    timeout: 30
  drivers.tt_smc_remoteproc.bl1_primary.quasar:
    tags: smoke
    platform_allow:
      - tt_qsr1a1/tt_keraunos/smc
    sysbuild: true
    extra_args:
      - REMOTE_SMC_SOC=tt_quasar
      - tt_smc_remoteproc_EXTRA_DTC_OVERLAY_FILE=boards/quasar_remote.overlay
    harness: console
    harness_config:
      type: one_line
      regex:
        - "Secondary BL1 is running on tt_qsr1a1/tt_quasar/smc!"
    timeout: 30
```

## tests/drivers/watchdog/testcase.yaml
```yaml
tests:
  drivers.watchdog.basic:
    tags: smoke
    platform_allow:
      - tt_mimir/tt_mimir/smc
      - tt_mmk/tt_keraunos/smc
      - tt_mmk/tt_mimir/smc
      - tt_qsr1a1/tt_keraunos/smc
      - tt_qsr1a1/tt_mimir/smc
      - tt_qsr1a1/tt_quasar/smc
    extra_args:
      - DTC_OVERLAY_FILE=tt_grendel.overlay
```

## tests/lib/tenstorrent/bh_arc/gddr_cal/testcase.yaml
```yaml
common:
  platform_allow:
    - native_sim
  tags: bh_arc
tests:
  lib.tenstorrent.bh_arc.gddr_cal: {}
```

## tests/lib/tenstorrent/occp/testcase.yaml
```yaml
common:
  tags:
    - drivers
tests:
  lib.tenstorrent.occp:
    tags: smoke
    platform_allow:
      - tt_mimir/tt_mimir/smc
  lib.tenstorrent.occp.native_sim:
    platform_allow:
      - native_sim
    extra_configs:
      - CONFIG_OCCP_BACKEND_FAKE=y
```

## tests/lib/tenstorrent/sep_bl1/testcase.yaml
```yaml
tests:
  lib.tenstorrent.sep_bl1:
    platform_allow: native_sim/native/64
    tags:
      - sep
      - boot
```

## west.yml
```yaml
# Copyright (c) 2024 Tenstorrent AI ULC
# SPDX-License-Identifier: Apache-2.0

manifest:
  remotes:
    - name: tenstorrent
      url-base: https://github.com/tenstorrent
    - name: tenstorrent-forks
      url-base: https://github.com/tenstorrent-forks
    - name: openbmc
      url-base: https://github.com/openbmc

  # zephyr-keep-sorted-start re(^\s+\- name:)
  projects:
    - name: libpldm
      remote: openbmc
      path: modules/lib/libpldm
      revision: 1c4a11442648a7ac670167b4d306a70376a35cc2
    - name: librpmi
      remote: tenstorrent-forks
      path: modules/lib/librpmi
      revision: 23e94f7007731e91be4de7c1d9c8c48b2173f6a2
    - name: zephyr
      # TEMP
      url: https://github.com/alayander/zephyr
      revision: af3d80bc634eea6d6fdd1853a7452c8020f52a44
      import:
        name-allowlist:
          - cmsis_6
          - hal_stm32
          - libmctp
          - mbedtls
          - mcuboot
          - nanopb
          - segger
          - tf-psa-crypto
  # zephyr-keep-sorted-stop

  group-filter:
    - +optional
```
