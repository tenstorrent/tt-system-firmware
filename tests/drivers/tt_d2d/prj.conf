## CMakeLists.txt
```
# Copyright (c) 2026 Tenstorrent AI ULC
# SPDX-License-Identifier: Apache-2.0

cmake_minimum_required(VERSION 3.20.0)

# By default the test stands in a generated image of its own. The real D2D
# firmware arrives in the Sival drop and is not in this tree.
#
# Pass -DD2D_FW_BIN=<path> to run against the real image instead.
if(D2D_FW_BIN)
  set(D2D_FW_BLOB_FILE "${D2D_FW_BIN}")

  if(NOT IS_ABSOLUTE "${D2D_FW_BLOB_FILE}")
    set(D2D_FW_BLOB_FILE "${CMAKE_CURRENT_SOURCE_DIR}/${D2D_FW_BLOB_FILE}")
  endif()

  if(NOT EXISTS "${D2D_FW_BLOB_FILE}")
    message(FATAL_ERROR
            "D2D_FW_BIN names no such file:\n  ${D2D_FW_BLOB_FILE}\n"
            "The image ships in the Sival tarball drop.")
  endif()

  # tt_d2d_load_fw() copies the image a word at a time and rejects a length
  # that is not a multiple of four. Catching that here names the offending
  # file; left to run time it is an -EINVAL from a call whose arguments look
  # fine.
  file(SIZE "${D2D_FW_BLOB_FILE}" d2d_fw_blob_size)
  math(EXPR d2d_fw_blob_tail "${d2d_fw_blob_size} % 4")
  if(NOT d2d_fw_blob_tail EQUAL 0)
    message(FATAL_ERROR
            "D2D firmware image is ${d2d_fw_blob_size} bytes, which is not a "
            "multiple of 4 and cannot be loaded:\n  ${D2D_FW_BLOB_FILE}")
  endif()
else()
  set(D2D_FW_STUB_UNIT "TT-D2D-FW-STUB..")
  set(D2D_FW_STUB_REPEAT 16)
  set(D2D_FW_BLOB_FILE "${CMAKE_CURRENT_BINARY_DIR}/d2d_fw_stub.bin")

  string(REPEAT "${D2D_FW_STUB_UNIT}" ${D2D_FW_STUB_REPEAT} d2d_fw_stub_bytes)
  file(WRITE "${D2D_FW_BLOB_FILE}" "${d2d_fw_stub_bytes}")
endif()

find_package(Zephyr REQUIRED HINTS $ENV{ZEPHYR_BASE})
project(tt_d2d)

# The loader suite and the training suite are separate images rather than two
# suites in one: the loader tests end with a tile loaded and started, which is
# not the state training starts from, and only one of the two can run on a
# single die anyway.
if(CONFIG_TT_D2D_TEST_TRAIN)
  target_sources(app PRIVATE src/train.c)
else()
  target_sources(app PRIVATE src/main.c)
endif()

target_sources(app PRIVATE src/chip_init.c src/d2d_fw_blob.c)

# Turns the image into byte initialisers for d2d_fw_blob.c to include. The
# generated file depends on the image, so a new drop rebuilds it.
set(gen_dir ${ZEPHYR_BINARY_DIR}/misc/generated)
generate_inc_file_for_target(app "${D2D_FW_BLOB_FILE}" ${gen_dir}/d2d_fw.inc)
target_include_directories(app PRIVATE ${gen_dir})

# So the test checks the image it generated rather than a copy of the pattern
# that could drift from it. Absent when running against a real image, whose
# contents the test has no business asserting.
if(D2D_FW_STUB_UNIT)
  target_compile_definitions(app PRIVATE
                             D2D_FW_STUB_UNIT="${D2D_FW_STUB_UNIT}"
                             D2D_FW_STUB_REPEAT=${D2D_FW_STUB_REPEAT})
endif()

# chip_init.c calls the drop's basic_init library rather than restating the
# reset and firewall sequence.
target_link_libraries(app PRIVATE gr_smc)
```

## Kconfig
```
# Copyright (c) 2026 Tenstorrent AI ULC
# SPDX-License-Identifier: Apache-2.0

source "Kconfig.zephyr"

config TT_D2D_TEST_TRAIN
	bool "Build the two-die link training suite instead of the loader suite"
	help
	  The loader suite runs on a single die. Training needs a second die
	  running the other end of the link, so the two cannot share a run:
	  the loader tests leave the tile loaded and started, which is not
	  where training wants to begin. Selecting this builds an image that
	  trains the link and nothing else.

config TT_D2D_TEST_TRAIN_KERAUNOS
	bool "Train the Mimir1-to-Keraunos link as well"
	depends on TT_D2D_TEST_TRAIN
	help
	  Build the Mimir image for an MMK package rather than an MM one.
	  Keraunos adds a second link, from its D2D2 to Mimir1's D2D1, which
	  makes Mimir1 the die in the middle with a tile at each end. Without
	  this Mimir1 brings up only the tile facing Mimir0, and Keraunos0's
	  end of the second link would wait for a partner that never loads.

	  Has no effect on the Keraunos image, which exists only in a package
	  that has one.
```

## prj.conf
```kconfig
CONFIG_TT_D2D=y
# Pulls in the gr_smc lib, whose basic_init/firewall/smc_init sources chip_init.c calls into.
# gr_smc selects SIVAL_SDK, which is needed even on tt_mimir/tt_mimir/smc.
CONFIG_TT_GR_SMC=y
# d2d0 loads over DMA, d2d1 over CPU stores, so a run covers both paths.
CONFIG_DMA=y
CONFIG_LOG=y
CONFIG_TT_D2D_LOG_LEVEL_DBG=y
CONFIG_TEST=y
CONFIG_ZTEST=y
# Makes a passing suite write 0xACAFACA1 to scratch[0] as well as reporting on
# the console. Emulation has no console reader, so without this a run that
# passes is indistinguishable from one that never finished.
CONFIG_ZTEST_TC_UTIL_USER_OVERRIDE=y
# VDK simulation does not support programming the PMP with stack protection
CONFIG_TEST_HW_STACK_PROTECTION=n
```

## app.overlay
```dts
/*
 * Copyright (c) 2026 Tenstorrent AI ULC
 *
 * SPDX-License-Identifier: Apache-2.0
 */

/*
 * d2d0 carries the emulation bypasses and d2d1 deliberately does not, so the
 * test can tell the flags are coming from devicetree rather than being applied
 * unconditionally by the driver.
 *
 * The split is reused for the transfer path: only d2d0 names a DMA channel, so
 * a run exercises both the DMA route and the CPU-store fallback and the two
 * have to agree on what ends up in SRAM.
 */

&d2d0 {
	status = "okay";
	dmas = <&dma0 0>;
	dma-names = "fw";
	bypass-phy;
	bypass-vreg;
	disable-sideband;
};

&d2d1 {
	status = "okay";
};

/*
 * Link at the SMC SPM base rather than the board's usual ram0 base.
 *
 * The ZeBu harnesses that run this test load the image at the SPM alias base,
 * 0xc0060000, and on the two-die path (chippy's sip/m2m_run_emu) that address
 * is fixed: only the reset vector is configurable. ram0 starts 0x7000 above it
 * to clear the bundle loader staging area and to keep vuart_ram at a fixed
 * address across the BL0P5 -> BL1 -> MIS handoffs. Leaving the two disagreeing
 * means the cores come out of reset onto whatever sits at the vector, which
 * presents as neither die ever running.
 *
 * Nothing here needs the reclaimed 0x7000: this test loads no bundles and does
 * not talk to OCCP. The top stops short of vuart_ram at 0xc0158000.
 */
&ram0 {
	reg = <0x0 0xc0060000 0x0 0xf8000>;
};
```

## keraunos_train.overlay
```dts
/*
 * Copyright (c) 2026 Tenstorrent AI ULC
 *
 * SPDX-License-Identifier: Apache-2.0
 */

/*
 * The Keraunos end of the MMK D2D link.
 *
 * Keraunos has five D2D tiles, one per HSIO tile, and the link to Mimir1
 * leaves on D2D2. The other four stay off, and not just because nothing uses
 * them: each sits inside an HSIO tile that this test never clocks or opens the
 * firewalls in front of, so touching one would hang on an unanswered bus
 * rather than fail. The suite releases the reset of every tile devicetree has
 * enabled, which makes leaving them disabled here the thing that keeps it away
 * from them.
 *
 * app.overlay turns on d2d0 and d2d1 for the loader suite, which runs on
 * Mimir, where those are the two tiles that exist. Turning them back off is
 * what makes that overlay harmless here.
 */

&d2d0 {
	status = "disabled";
};

&d2d1 {
	status = "disabled";
};

/*
 * Bypasses matching the reference bring-up for this package: PHY and sideband
 * bypassed because emulation does not model them, the regulator left to
 * initialise for real because it does. The same combination the Mimir ends use
 * in train.overlay -- both ends of a link have to agree.
 *
 * No DMA channel: the tile is reached through the HSIO fabric rather than
 * directly off the management network, and the CPU-store path the driver falls
 * back to needs nothing beyond the firewalls this test already opens.
 */
&d2d2 {
	status = "okay";
	bypass-phy;
	disable-sideband;
};
```

## train.overlay
```dts
/*
 * Copyright (c) 2026 Tenstorrent AI ULC
 *
 * SPDX-License-Identifier: Apache-2.0
 */

/*
 * Training uses whichever tile faces the other die: d2d1 on Mimir0, d2d0 on
 * Mimir1. Both ends therefore have to be configured for the platform the test
 * runs on, and this one runs on emulation.
 *
 * app.overlay deliberately leaves d2d1 without the emulation bypasses so the
 * loader suite can show the flags are coming from devicetree rather than being
 * applied unconditionally by the driver. That asymmetry is fine when nothing
 * has to talk to anything, but here it would leave Mimir0's end trying to
 * bring up a PHY and regulator that emulation does not model, waiting on a PLL
 * lock that never arrives, while Mimir1's end is bypassed and ready. Give both
 * ends the same treatment.
 */

&d2d1 {
	bypass-phy;
	disable-sideband;
};

/*
 * The reference bring-up for this package runs the regulator init for real
 * even on emulation -- it bypasses the PHY and the sideband, but not the
 * regulator. app.overlay sets bypass-vreg on d2d0 to give the loader suite a
 * tile with every flag set; keeping it here would mean training against a
 * configuration nothing else uses.
 */
&d2d0 {
	/delete-property/ bypass-vreg;
};
```

## src/main.c
```c
/*
 * Copyright (c) 2026 Tenstorrent AI ULC
 *
 * SPDX-License-Identifier: Apache-2.0
 */

#include <zephyr/device.h>
#include <zephyr/devicetree.h>
#include <zephyr/sys/byteorder.h>
#include <zephyr/sys/sys_io.h>
#include <zephyr/ztest.h>

#include <soc.h>

#include <zephyr/drivers/misc/tt_d2d.h>

#include "chip_init.h"
#include "d2d_fw_blob.h"

/*
 * Mirrors of the driver's private layout. Duplicated on purpose: the test is
 * checking that the driver puts things at these offsets, so sharing a header
 * would let both drift together without failing.
 */
#define SRAM_OFFSET     0x2000U
#define CPU_CTRL_OFFSET 0x1800U
#define VERSION_OFFSET  0x1014U
#define CFG_OFFSET      0xFCC0U
#define IMAGE_MAX       CFG_OFFSET

#define CFG_MAGIC_VALUE 0x1234BEAFU
#define CPU_CTRL_HALT   0x00010001U
#define CPU_CTRL_START  0x00010000U
#define PROBE_PATTERN   0xD2D0F00DU

#define CFG_IDX_MAGIC            0U
#define CFG_IDX_BITS_PER_CHANNEL 1U
#define CFG_IDX_PLL_FREQ_GHZ     4U
#define CFG_IDX_BYPASS_VREG      7U
#define CFG_IDX_BYPASS_PHY       17U
#define CFG_IDX_DISABLE_SIDEBAND 18U

#define D2D0_NODE DT_NODELABEL(d2d0)
#define D2D1_NODE DT_NODELABEL(d2d1)

static const struct device *const d2d0 = DEVICE_DT_GET(D2D0_NODE);
static const struct device *const d2d1 = DEVICE_DT_GET(D2D1_NODE);

#define D2D0_BASE DT_REG_ADDR(D2D0_NODE)
#define D2D1_BASE DT_REG_ADDR(D2D1_NODE)

/* Word i is distinguishable from both zero and its own offset. */
#define IMAGE_WORDS 64U
static uint32_t test_image[IMAGE_WORDS];

static uint32_t cfg_read(uintptr_t base, uint32_t index)
{
	return sys_read32(base + SRAM_OFFSET + CFG_OFFSET + (index * sizeof(uint32_t)));
}

/*
 * The only thing visible from the host while the tests run are the scratch registers
 * which the harness prints on every poll.
 * Each step publishes which test it is in and how far it got, so a run that stops
 * responding names the call it stopped in instead of just failing to reach the
 * pass token. scratch[4] carries the value the step just produced for example a
 * driver return code.
 *
 * The tag makes step 0 distinguishable from a scratch register nobody has
 * written yet.
 */
#define STEP(test, step) WRITE_SCRATCH(3, 0xB0000000U | ((test) << 8) | (step))
#define STEP_RESULT(val) WRITE_SCRATCH(4, (uint32_t)(val))

#define T_SETUP  0x00U
#define T_IMAGE  0x10U
#define T_CLEAR  0x20U
#define T_CONFIG 0x30U
#define T_BYPASS 0x40U
#define T_ARGS   0x50U
#define T_START  0x60U
#define T_BLOB   0x70U
#define T_EXEC   0x80U

/*
 * A failing assertion ends its test but not the suite, and the suite's pass
 * token is only written if every test passed -- so without this a run with one
 * broken test is indistinguishable from a run with six. Each test sets its bit
 * on the way out; whatever is missing at the end failed.
 */
static uint32_t passed_mask;

#define PASSED(bit)                                                                                \
	do {                                                                                       \
		passed_mask |= BIT(bit);                                                           \
		WRITE_SCRATCH(1, 0xA5000000U | passed_mask);                                       \
	} while (0)

#define P_IMAGE  0
#define P_CLEAR  1
#define P_CONFIG 2
#define P_BYPASS 3
#define P_ARGS   4
#define P_START  5
#define P_BLOB   6
#define P_EXEC   7

static void *tt_d2d_setup(void)
{
	for (uint32_t i = 0; i < IMAGE_WORDS; i++) {
		test_image[i] = 0xD2D00000U + i;
	}

	STEP(T_SETUP, 1);
	zassert_true(device_is_ready(d2d0), "d2d0 not ready");
	zassert_true(device_is_ready(d2d1), "d2d1 not ready");

	/* Without this the tiles do not answer and every load fails -ENODEV. */
	STEP(T_SETUP, 2);
	zassert_ok(tt_d2d_test_chip_init(), "chip init failed");

	STEP(T_SETUP, 3);
	zassert_ok(tt_d2d_reset_release(d2d0), "d2d0 reset release failed");
	STEP(T_SETUP, 4);
	zassert_ok(tt_d2d_reset_release(d2d1), "d2d1 reset release failed");

	/*
	 * Walk d2d0 by hand up to the point tt_d2d_load_fw() starts from, and
	 * leave each answer in its own scratch register rather than the shared
	 * step result, so all three survive to the end of the run. A load that
	 * wedges is then attributable: if these three are right, the tile was
	 * reachable and the driver lost it later.
	 *
	 * d2d_version is read-only and valid with the Rocket still in reset,
	 * which is what the reference bring-up checks first; cpu_ctrl confirms
	 * uncore reset actually cleared; the SRAM word confirms the window that
	 * clearing opens is writable.
	 */
	STEP(T_SETUP, 5);
	WRITE_SCRATCH(5, sys_read32(D2D0_BASE + VERSION_OFFSET));

	STEP(T_SETUP, 6);
	sys_write32(CPU_CTRL_HALT, D2D0_BASE + CPU_CTRL_OFFSET);
	STEP(T_SETUP, 7);
	WRITE_SCRATCH(6, sys_read32(D2D0_BASE + CPU_CTRL_OFFSET));

	STEP(T_SETUP, 8);
	sys_write32(PROBE_PATTERN, D2D0_BASE + SRAM_OFFSET);
	STEP(T_SETUP, 9);
	WRITE_SCRATCH(7, sys_read32(D2D0_BASE + SRAM_OFFSET));

	STEP(T_SETUP, 10);

	return NULL;
}

ZTEST(tt_d2d, test_load_writes_image)
{
	int ret;

	STEP(T_IMAGE, 1);
	ret = tt_d2d_load_fw(d2d0, (const uint8_t *)test_image, sizeof(test_image));
	STEP(T_IMAGE, 2);
	STEP_RESULT(ret);
	zassert_ok(ret);

	STEP(T_IMAGE, 3);
	for (uint32_t i = 0; i < IMAGE_WORDS; i++) {
		uint32_t got = sys_read32(D2D0_BASE + SRAM_OFFSET + (i * sizeof(uint32_t)));

		STEP_RESULT(got);
		zassert_equal(got, test_image[i], "word %u: expected 0x%08x got 0x%08x", i,
			      test_image[i], got);
	}

	PASSED(P_IMAGE);
}

ZTEST(tt_d2d, test_load_clears_sram_beyond_image)
{
	/* Dirty a word past the image so a load that only writes the image
	 * itself, without clearing, would leave it behind.
	 */
	uintptr_t stale = D2D0_BASE + SRAM_OFFSET + sizeof(test_image);
	int ret;

	STEP(T_CLEAR, 1);
	sys_write32(0xDEADBEEF, stale);

	STEP(T_CLEAR, 2);
	ret = tt_d2d_load_fw(d2d0, (const uint8_t *)test_image, sizeof(test_image));
	STEP(T_CLEAR, 3);
	STEP_RESULT(ret);
	zassert_ok(ret);

	STEP(T_CLEAR, 4);
	STEP_RESULT(sys_read32(stale));
	zassert_equal(sys_read32(stale), 0, "SRAM past the image was not cleared");

	PASSED(P_CLEAR);
}

ZTEST(tt_d2d, test_load_writes_config_block)
{
	int ret;

	STEP(T_CONFIG, 1);
	ret = tt_d2d_load_fw(d2d0, (const uint8_t *)test_image, sizeof(test_image));
	STEP(T_CONFIG, 2);
	STEP_RESULT(ret);
	zassert_ok(ret);

	STEP(T_CONFIG, 3);
	STEP_RESULT(cfg_read(D2D0_BASE, CFG_IDX_MAGIC));
	zassert_equal(cfg_read(D2D0_BASE, CFG_IDX_MAGIC), CFG_MAGIC_VALUE,
		      "config magic missing; firmware would ignore the block");

	STEP(T_CONFIG, 4);
	STEP_RESULT(cfg_read(D2D0_BASE, CFG_IDX_BITS_PER_CHANNEL));
	zassert_equal(cfg_read(D2D0_BASE, CFG_IDX_BITS_PER_CHANNEL),
		      DT_PROP(D2D0_NODE, bits_per_channel));

	STEP(T_CONFIG, 5);
	STEP_RESULT(cfg_read(D2D0_BASE, CFG_IDX_PLL_FREQ_GHZ));
	zassert_equal(cfg_read(D2D0_BASE, CFG_IDX_PLL_FREQ_GHZ), DT_PROP(D2D0_NODE, pll_freq_ghz));

	PASSED(P_CONFIG);
}

ZTEST(tt_d2d, test_bypass_flags_follow_devicetree)
{
	int ret;

	STEP(T_BYPASS, 1);
	ret = tt_d2d_load_fw(d2d0, (const uint8_t *)test_image, sizeof(test_image));
	STEP(T_BYPASS, 2);
	STEP_RESULT(ret);
	zassert_ok(ret);

	STEP(T_BYPASS, 3);
	ret = tt_d2d_load_fw(d2d1, (const uint8_t *)test_image, sizeof(test_image));
	STEP(T_BYPASS, 4);
	STEP_RESULT(ret);
	zassert_ok(ret);

	/* d2d0 sets all three bypasses in the overlay, d2d1 sets none. */
	STEP(T_BYPASS, 5);
	STEP_RESULT(cfg_read(D2D0_BASE, CFG_IDX_BYPASS_PHY));
	zassert_equal(cfg_read(D2D0_BASE, CFG_IDX_BYPASS_PHY), 1);
	zassert_equal(cfg_read(D2D0_BASE, CFG_IDX_BYPASS_VREG), 1);
	zassert_equal(cfg_read(D2D0_BASE, CFG_IDX_DISABLE_SIDEBAND), 1);

	STEP(T_BYPASS, 6);
	STEP_RESULT(cfg_read(D2D1_BASE, CFG_IDX_BYPASS_PHY));
	zassert_equal(cfg_read(D2D1_BASE, CFG_IDX_BYPASS_PHY), 0);
	zassert_equal(cfg_read(D2D1_BASE, CFG_IDX_BYPASS_VREG), 0);
	zassert_equal(cfg_read(D2D1_BASE, CFG_IDX_DISABLE_SIDEBAND), 0);

	PASSED(P_BYPASS);
}

ZTEST(tt_d2d, test_load_rejects_bad_arguments)
{
	STEP(T_ARGS, 1);
	zassert_equal(tt_d2d_load_fw(d2d0, NULL, sizeof(test_image)), -EINVAL, "NULL image");
	zassert_equal(tt_d2d_load_fw(d2d0, (const uint8_t *)test_image, 0), -EINVAL, "empty image");
	zassert_equal(tt_d2d_load_fw(d2d0, (const uint8_t *)test_image, 6), -EINVAL,
		      "image length not a multiple of 4");

	/* Size is validated before the buffer is read, so a short buffer with an
	 * oversized length is safe and avoids allocating 64 KB in the test.
	 */
	zassert_equal(tt_d2d_load_fw(d2d0, (const uint8_t *)test_image, IMAGE_MAX + 4), -ENOSPC,
		      "image overlapping the config block");

	PASSED(P_ARGS);
}

ZTEST(tt_d2d, test_load_halts_and_start_releases)
{
	int ret;

	STEP(T_START, 1);
	ret = tt_d2d_load_fw(d2d0, (const uint8_t *)test_image, sizeof(test_image));
	STEP(T_START, 2);
	STEP_RESULT(ret);
	zassert_ok(ret);

	STEP(T_START, 3);
	STEP_RESULT(sys_read32(D2D0_BASE + CPU_CTRL_OFFSET));
	zassert_equal(sys_read32(D2D0_BASE + CPU_CTRL_OFFSET), CPU_CTRL_HALT,
		      "Rocket should still be in reset after a load");

	STEP(T_START, 4);
	zassert_ok(tt_d2d_start(d2d0));
	STEP(T_START, 5);
	STEP_RESULT(sys_read32(D2D0_BASE + CPU_CTRL_OFFSET));
	/* Only that core reset was deasserted. Whether the Rocket then fetched
	 * anything is test_started_firmware_executes' business; this readback
	 * looks the same either way.
	 */
	zassert_equal(sys_read32(D2D0_BASE + CPU_CTRL_OFFSET), CPU_CTRL_START,
		      "start did not clear core reset");

	PASSED(P_START);
}

/*
 * The firmware image is not compiled into the driver: it is a separate file,
 * embedded by this test and handed to the loader as a plain buffer. This is
 * the whole of that path, from the generated initialisers through to SRAM, so
 * a drop that lands truncated fails here rather than as a link that will not
 * train much later.
 *
 * The image under test is this test's generated stand-in, not the real
 * firmware; what is being checked is the mechanism carrying it.
 */
ZTEST(tt_d2d, test_linked_fw_image_loads)
{
	const uint8_t *img;
	size_t size = 0;
	int ret;

	STEP(T_BLOB, 1);
	img = d2d_fw_image(&size);
	STEP_RESULT(size);
	zassert_not_null(img, "no image linked in");
	zassert_true(size > 0, "linked image is empty");
	zassert_equal(size % sizeof(uint32_t), 0, "image of %zu bytes is not word-sized", size);
	zassert_true(size <= IMAGE_MAX, "image of %zu bytes overlaps the config block", size);

#ifdef D2D_FW_STUB_UNIT
	/* Only the generated stub has contents this test can predict, and
	 * checking them confirms the bytes are the file's rather than zeroes
	 * from a section that was allocated but never filled.
	 */
	{
		static const char unit[] = D2D_FW_STUB_UNIT;
		const size_t unit_len = sizeof(unit) - 1;

		zassert_equal(size, unit_len * D2D_FW_STUB_REPEAT, "stub is %zu bytes", size);

		STEP(T_BLOB, 2);
		for (size_t i = 0; i < size; i++) {
			STEP_RESULT(img[i]);
			zassert_equal(img[i], unit[i % unit_len],
				      "image byte %zu is 0x%02x, expected 0x%02x", i, img[i],
				      unit[i % unit_len]);
		}
	}
#endif

	STEP(T_BLOB, 3);
	ret = tt_d2d_load_fw(d2d0, img, size);
	STEP(T_BLOB, 4);
	STEP_RESULT(ret);
	zassert_ok(ret, "loading the linked image failed");

	STEP(T_BLOB, 5);
	for (size_t off = 0; off < size; off += sizeof(uint32_t)) {
		uint32_t got = sys_read32(D2D0_BASE + SRAM_OFFSET + off);
		uint32_t want = sys_get_le32(&img[off]);

		STEP_RESULT(got);
		zassert_equal(got, want, "SRAM +0x%zx is 0x%08x, expected 0x%08x", off, got, want);
	}

	PASSED(P_BLOB);
}

/*
 * Everything above this point stops at the loader: it shows bytes arriving in
 * SRAM and the control register accepting a write, neither of which needs the
 * Rocket to have executed a single instruction.
 *
 * This is the one test that distinguishes a core that ran from a core that is
 * wedged, and it does it without a link partner, a PHY, or anything the
 * emulation bypasses turn off. The loader zeroes the whole window before
 * copying, so between the end of the image and the config block there is a
 * region that is known to be zero and that the loader will not touch again.
 * Anything non-zero there after the Rocket is released was put there by the
 * Rocket. Confirming the region really is zero first is what makes that a
 * proof rather than an inference.
 *
 * A stack push is the earliest such write and lands near the top of the
 * window, hence the downward scan: when the firmware is alive the search ends
 * almost immediately, and only a genuine failure pays for the full sweep.
 */
/*
 * A live Rocket has written something before the first scan finishes: on
 * emulation the sweep alone takes well over a minute, which dwarfs the time
 * the core needs to reach its first store. The retries are there for margin,
 * not because a pass is expected to need them, and the count is kept low
 * deliberately -- each one is another full sweep, and enough of them would
 * turn a clean failure into a harness timeout with nothing to read.
 */
#define EXEC_ATTEMPTS     3U
#define EXEC_SETTLE_ITERS 0x1000U

/* Offset of the highest non-zero word below `end`, or `end` if there is none. */
static size_t highest_nonzero(uintptr_t sram, size_t start, size_t end)
{
	for (size_t off = end; off > start;) {
		off -= sizeof(uint32_t);

		if (sys_read32(sram + off) != 0) {
			return off;
		}
	}

	return end;
}

ZTEST(tt_d2d, test_started_firmware_executes)
{
	const uintptr_t sram = D2D0_BASE + SRAM_OFFSET;
	const uint8_t *img;
	size_t size = 0;
	size_t hit;
	int ret;

#ifdef D2D_FW_STUB_UNIT
	/* The generated stand-in is ASCII, not instructions. Releasing a core
	 * onto it would prove nothing and leave it in an arbitrary state.
	 */
	ztest_test_skip();
#endif

	STEP(T_EXEC, 1);
	img = d2d_fw_image(&size);
	zassert_true(size > 0 && size < IMAGE_MAX, "no room between image and config block");

	STEP(T_EXEC, 2);
	ret = tt_d2d_load_fw(d2d0, img, size);
	STEP_RESULT(ret);
	zassert_ok(ret);

	STEP(T_EXEC, 3);
	hit = highest_nonzero(sram, size, IMAGE_MAX);
	STEP_RESULT(hit);
	zassert_equal(hit, IMAGE_MAX,
		      "SRAM +0x%zx is already non-zero with the Rocket still in "
		      "reset, so a later write there would prove nothing",
		      hit);

	STEP(T_EXEC, 4);
	zassert_ok(tt_d2d_start(d2d0));

	for (uint32_t attempt = 0; attempt < EXEC_ATTEMPTS; attempt++) {
		STEP(T_EXEC, 5);
		for (volatile uint32_t i = 0; i < EXEC_SETTLE_ITERS; i++) {
		}

		STEP(T_EXEC, 6);
		hit = highest_nonzero(sram, size, IMAGE_MAX);
		if (hit != IMAGE_MAX) {
			break;
		}
	}

	STEP_RESULT(hit);
	zassert_not_equal(hit, IMAGE_MAX,
			  "SRAM is untouched after releasing the Rocket: it is not executing the "
			  "image. Check that the load landed (earlier tests) and that the core "
			  "reset in cpu_ctrl actually deasserted");

	PASSED(P_EXEC);
}

/*
 * The harness's verdict is ztest's own, and ztest can fail a run for reasons
 * no individual test reports: a result recorded outside a test body, or
 * per-test stats that do not add up. With no readable console, publishing the
 * framework's counters is what separates "a test failed" from "every test
 * passed and the run was failed anyway".
 */
static void tt_d2d_teardown(void *fixture)
{
	uint32_t run = 0;
	uint32_t pass = 0;
	uint32_t fail = 0;
	uint32_t skip = 0;
	uint32_t inconsistent = 0;

	ARG_UNUSED(fixture);

	for (struct ztest_unit_test *t = _ztest_unit_test_list_start; t < _ztest_unit_test_list_end;
	     t++) {
		run += t->stats->run_count;
		pass += t->stats->pass_count;
		fail += t->stats->fail_count;
		skip += t->stats->skip_count;

		if (t->stats->pass_count + t->stats->fail_count + t->stats->skip_count !=
		    t->stats->run_count) {
			inconsistent = 1;
		}
	}

	WRITE_SCRATCH(4, 0xC0000000U | (run << 16) | (pass << 12) | (fail << 8) | (skip << 4) |
				 inconsistent);
}

ZTEST_SUITE(tt_d2d, NULL, tt_d2d_setup, NULL, NULL, tt_d2d_teardown);
```

## src/chip_init.c
```c
/*
 * Copyright (c) 2026 Tenstorrent AI ULC
 *
 * SPDX-License-Identifier: Apache-2.0
 */

/*
 * What the Sival drop's own init does before it goes near a D2D tile, called
 * out of the drop's libraries rather than restated here.
 *
 * The two platforms differ by more than register names. On Mimir the D2D tiles
 * hang off the management network directly, so lifting the cold resets over
 * them and their interconnect and opening the firewall filters is the whole
 * job. On Keraunos each D2D sits inside an HSIO tile with its own reset
 * controller and clock, none of which answers until the tile around it is up,
 * so the same job runs one level deeper and in a stricter order.
 */

#include <errno.h>

#include <zephyr/kernel.h>
#include <zephyr/sys/sys_io.h>

#include <basic_init.h>
#include <clock.h>
#include <firewall.h>
#include <platform.h>

#include "chip_init.h"

#if defined(CONFIG_SOC_TT_KERAUNOS_SMC)

#include <hsio_tile_init.h>

/*
 * The tile the K2M link leaves on, and with it the HSIO tile it lives in: the
 * D2D instance and the HSIO tile carry the same index, and the reference
 * bring-up for this package uses 2.
 */
#define KER_LINK_HSIO_TILE 2U

/*
 * Every HSIO tile from 0 up to the target has to be out of cold reset, not
 * just the target: they sit on the management network ring in order, and the
 * ring has to be continuous for SMC traffic to reach the far one at all.
 */
#define KER_HSIO_RESET_MASK                                                                        \
	(KER_RST_HSIO0 | (KER_RST_HSIO0 << 1) | (KER_RST_HSIO0 << KER_LINK_HSIO_TILE))

int tt_d2d_test_chip_init(void)
{
	grendel_err_t err;

	/*
	 * Blocks sample their straps at whatever rate is running as they come
	 * out of cold reset, so the reference clock stays selected until the
	 * tile is assembled.
	 */
	config_cce_clock(0);

	smc_release_reset(KER_RST_SMN | KER_HSIO_RESET_MASK | KER_RST_D2D2);

	/* Refclk has to reach the tile before any register in it is touched. */
	enable_hsio_clk(KER_LINK_HSIO_TILE, 0);

	/*
	 * The SMC filters and the two SMN filters in front of the tile, rather
	 * than disable_ker_smn_filters(), which also walks the PCIe filters --
	 * those live behind PCIe's own cold reset and hang the bus when it is
	 * still held, which here it is.
	 */
	err = disable_ker_smc_filters();
	if (err != GRENDEL_ERR_OK) {
		return -EIO;
	}

	err = disable_firewall_filters(KER_SMN_HSIO2HSIO, KER_LINK_HSIO_TILE);
	if (err != GRENDEL_ERR_OK) {
		return -EIO;
	}

	err = disable_firewall_filters(KER_SMN_HSIO2SMN, KER_LINK_HSIO_TILE);
	if (err != GRENDEL_ERR_OK) {
		return -EIO;
	}

	/*
	 * Inside the tile now. The SMC reset unit only ungates the tile as a
	 * whole; its blocks come out through the tile's own controller.
	 */
	hsio_tile_release_cold_reset(KER_LINK_HSIO_TILE,
				     HSIO_RST_CCE0 | HSIO_RST_CCE1 | HSIO_RST_TL1 |
					     HSIO_RST_FABRIC);

	/*
	 * Unlike Mimir, the switch to the PLL belongs here rather than after
	 * the D2D straps are released: the straps are inside the tile and do
	 * not answer until it is clocked and its filters are open. See
	 * tt_d2d_test_chip_clock_up().
	 */
	config_cce_clock(1);
	enable_hsio_clk(KER_LINK_HSIO_TILE, 1);

	err = disable_ker_hsio_filters(KER_LINK_HSIO_TILE);
	if (err != GRENDEL_ERR_OK) {
		return -EIO;
	}

	return 0;
}

int tt_d2d_test_chip_clock_up(void)
{
	/* Already done above, where this platform needs it. */
	return 0;
}

#else /* Mimir */

int tt_d2d_test_chip_init(void)
{
	grendel_err_t err;

	smc_release_reset(MIMIR_RST_SMN | MIMIR_RST_ITN | MIMIR_RST_D2D0 | MIMIR_RST_D2D1);

	err = disable_all_mimir_firewall_filters();
	if (err != GRENDEL_ERR_OK) {
		return -EIO;
	}

	return 0;
}

int tt_d2d_test_chip_clock_up(void)
{
	config_cce_clock(1);

	return 0;
}

#endif
```

## src/chip_init.h
```c
/*
 * Copyright (c) 2026 Tenstorrent AI ULC
 *
 * SPDX-License-Identifier: Apache-2.0
 */

#ifndef TT_D2D_TEST_CHIP_INIT_H_
#define TT_D2D_TEST_CHIP_INIT_H_

/**
 * @brief Make the D2D tiles reachable from this SMC.
 *
 * Lifts the subsystem cold resets covering the D2D tiles and their
 * interconnect, then opens the firewall filters in front of them. Both are
 * prerequisites of tt_d2d_load_fw() and neither belongs to the D2D driver:
 * they are chip-wide, and in a shipping system BL1 will have done them long
 * before any tile is loaded. The test does them itself so it can run
 * standalone.
 *
 * On Keraunos this also covers the HSIO tile the D2D sits behind, which Mimir
 * has no equivalent of.
 *
 * @return 0 on success, -EIO if the drop rejected a filter configuration.
 */
int tt_d2d_test_chip_init(void);

/**
 * @brief Switch the CCE clock from the reference to the PLL.
 *
 * Called after the D2D straps are released. The firmware brings up its own
 * PLL against this clock and reports a lock failure if it is still running off
 * the reference, so it has to happen before an image is loaded.
 *
 * It is a separate call from tt_d2d_test_chip_init() because the two platforms
 * want it on opposite sides of the strap release. Mimir samples the straps at
 * whatever rate is running when they come out, so it releases them on the
 * reference and switches afterwards -- which is what this does. Keraunos puts
 * its D2D behind an HSIO tile that has to be clocked and have its firewalls
 * open before the straps answer at all, so there the switch has already
 * happened inside tt_d2d_test_chip_init() and this is a no-op. Callers get one
 * order that is correct on both.
 *
 * @return 0 on success.
 */
int tt_d2d_test_chip_clock_up(void);

#endif /* TT_D2D_TEST_CHIP_INIT_H_ */
```

## src/d2d_fw_blob.c
```c
/*
 * Copyright (c) 2026 Tenstorrent AI ULC
 *
 * SPDX-License-Identifier: Apache-2.0
 */

/*
 * Embeds an image in the test so it has something to hand tt_d2d_load_fw().
 * This lives here rather than beside the driver on purpose: a production image
 * gets the firmware as its own bundle entry and passes the driver a pointer to
 * it, so nothing under drivers/ should be able to embed it.
 *
 * d2d_fw.inc holds the image named by this test's CMakeLists, as a list of
 * byte initialisers.
 */

#include <zephyr/toolchain.h>

#include "d2d_fw_blob.h"

/* tt_d2d_load_fw() reads the image with 32-bit loads. */
static const uint8_t d2d_fw_bin[] __aligned(sizeof(uint32_t)) = {
#include "d2d_fw.inc"
};

const uint8_t *d2d_fw_image(size_t *size)
{
	if (size != NULL) {
		*size = sizeof(d2d_fw_bin);
	}

	return d2d_fw_bin;
}
```

## src/d2d_fw_blob.h
```c
/*
 * Copyright (c) 2026 Tenstorrent AI ULC
 *
 * SPDX-License-Identifier: Apache-2.0
 */

#ifndef TESTS_DRIVERS_TT_D2D_D2D_FW_BLOB_H_
#define TESTS_DRIVERS_TT_D2D_D2D_FW_BLOB_H_

#include <stddef.h>
#include <stdint.h>

/**
 * @brief Get the D2D firmware image embedded in this test.
 *
 * @param[out] size Length of the image in bytes, or NULL if not wanted
 *
 * @return Pointer to the image, suitable for passing to tt_d2d_load_fw()
 */
const uint8_t *d2d_fw_image(size_t *size);

#endif /* TESTS_DRIVERS_TT_D2D_D2D_FW_BLOB_H_ */
```

## src/train.c
```c
/*
 * Copyright (c) 2026 Tenstorrent AI ULC
 *
 * SPDX-License-Identifier: Apache-2.0
 */

/*
 * D2D link training between two dies.
 *
 * The loader suite stops where the Rocket starts running. Everything it
 * checks happens inside one tile, so it runs on a single die and says nothing
 * about whether a link works. Training is the first step that cannot be faked
 * that way: the two firmwares negotiate with each other over the wires, and
 * neither finishes unless the other is also loaded and running. That makes it
 * the cheapest end-to-end evidence that D2D is alive.
 *
 * In an MM package one link runs, between Mimir0's D2D1 and Mimir1's D2D0.
 * Those two tiles face each other; the remaining tile on each die faces a
 * different neighbour and has no partner in this package, so bringing it up
 * here would only produce a timeout.
 *
 * An MMK package adds Keraunos, and with it a second link: Mimir1's D2D1 to
 * Keraunos0's D2D2. Mimir1 is the die in the middle and trains both of its
 * tiles, which is why a die owns a list of tiles here rather than one. The two
 * links come up in the same pass because the harness releases every Rocket
 * together and will not call the run a pass until all three dies report one --
 * there is no configuration that runs the Keraunos link on its own.
 *
 * Every Mimir boots the same image and every Keraunos the same one, each die
 * picking its end from the chip id the harness leaves in scratch[15].
 *
 * Neither side starts its own Rocket. Both ends have to be released close
 * together or training never converges, and a die can only see itself, so the
 * release is the host's job: each side loads its tile, publishes
 * TS_D2D_WAIT_TRAINING, and waits. Once every die has said that, the host
 * releases all the Rockets in one pass and the two firmwares find each other.
 * That is the drop's own protocol, and following it is what lets the stock
 * two-Mimir harness run this image unmodified.
 */

#include <errno.h>

#include <zephyr/device.h>
#include <zephyr/devicetree.h>
#include <zephyr/kernel.h>
#include <zephyr/sys/sys_io.h>
#include <zephyr/ztest.h>

#include <soc.h>

#include <zephyr/drivers/misc/tt_d2d.h>

#include <platform.h>
#include <test_codes.h>

#include "chip_init.h"
#include "d2d_fw_blob.h"

/*
 * Which die this is. The value is a chip id that will eventually come from
 * efuse; until then the harness writes it into the low byte of scratch[15]
 * before releasing the SMC, exactly as the drop's own M2M application reads
 * it.
 */
#define CHIP_ID_MASK   0xFFU
#define CHIP_ID_MIMIR0 0x03U
#define CHIP_ID_MIMIR1 0x13U
/*
 * Keraunos really is zero, which is also what an unwritten scratch reads. The
 * two are told apart by which image is running: a Keraunos build can only be
 * on a Keraunos die, and the Mimir build never accepts it.
 */
#define CHIP_ID_KERAUNOS0 0x00U

/*
 * The SMN sideband manager's D2D-select mux. Aliased because the generated
 * names are too long to use where they are needed.
 *
 * Mimir only, and not merely unused elsewhere: Keraunos reaches its D2D tiles
 * through the HSIO fabric and has no such mux, so the names do not exist in
 * its register map and referring to them would not compile.
 */
#if !defined(CONFIG_SOC_TT_KERAUNOS_SMC)
#define SMN_D2D_SELECT_CLR                                                                         \
	SMN_SMC2SMN_INIU_SIDEBANDMANAGER_D2D_SELECT_MAIN_SIDEBANDMANAGER_A_SIDEBANDMANAGER_D2D_SELECT_MAIN_SIDEBANDMANAGER_FLAGOUTCLR0_REG_ADDR
#define SMN_D2D_SELECT_SET                                                                         \
	SMN_SMC2SMN_INIU_SIDEBANDMANAGER_D2D_SELECT_MAIN_SIDEBANDMANAGER_A_SIDEBANDMANAGER_D2D_SELECT_MAIN_SIDEBANDMANAGER_FLAGOUTSET0_REG_ADDR
#endif

struct link_tile {
	const struct device *dev;
	uintptr_t base;
};

#define TILE(label)                                                                                \
	{                                                                                          \
		.dev = DEVICE_DT_GET(DT_NODELABEL(label)),                                         \
		.base = DT_REG_ADDR(DT_NODELABEL(label)),                                          \
	}

/*
 * Every tile this die has enabled, trained or not. They all come out of reset
 * together: a tile samples its straps at whatever rate is running at the time,
 * and the clock switch that ends that window is chip-wide, so a tile left
 * behind could not be strapped correctly afterwards. Taken from devicetree so
 * that what gets released follows what the overlay turned on -- on Keraunos
 * the tiles behind the other HSIO tiles stay off, and reaching for one of
 * those would hang on an unclocked bus rather than fail.
 */
#define TILE_ENTRY(node_id)                                                                        \
	{                                                                                          \
		.dev = DEVICE_DT_GET(node_id),                                                     \
		.base = DT_REG_ADDR(node_id),                                                      \
	},

static const struct link_tile chip_tiles[] = {DT_FOREACH_STATUS_OKAY(tenstorrent_grendel_d2d,
								     TILE_ENTRY)};

/*
 * Which of them face another die, per chip id.
 */
#if defined(CONFIG_SOC_TT_KERAUNOS_SMC)

/* Keraunos reaches Mimir1 through D2D2, in HSIO tile 2. */
static const struct link_tile tiles_keraunos0[] = {TILE(d2d2)};

#else

/* Mimir0 reaches Mimir1 through D2D1; Mimir1 answers on D2D0. */
static const struct link_tile tiles_mimir0[] = {TILE(d2d1)};

static const struct link_tile tiles_mimir1[] = {
	TILE(d2d0),
#ifdef CONFIG_TT_D2D_TEST_TRAIN_KERAUNOS
	/* The other side of Mimir1, facing Keraunos0's D2D2. */
	TILE(d2d1),
#endif
};

#endif

/*
 * Two waits, with very different shapes, kept apart so a failure says which
 * one ran out.
 *
 * The release is paced by the host: it has to notice both dies waiting before
 * it does anything, so the budget covers a round trip through a poll loop
 * outside this chip and is generous. Training afterwards is a fixed sequence
 * in the firmware rather than a retry loop, and with the PHY bypassed it is
 * short, so its budget is roughly what the drop allows its own poll. Both are
 * in emulated time, which is what the kernel clock counts here and what the
 * hardware actually experiences.
 */
#define RELEASE_TIMEOUT K_SECONDS(5)

/*
 * Training is waited for in slices so progress can be published between them.
 * The product is the budget; the slice is just how often the host hears about
 * it, and wants to stay well under the harness's own patience.
 */
#define TRAIN_SLICE  K_MSEC(10)
#define TRAIN_SLICES 100U

/*
 * Mirrors of the driver's layout, duplicated rather than shared for the same
 * reason the loader suite duplicates them: this is checking what the driver
 * did, and a shared header would let both drift together.
 */
#define CPU_CTRL_OFFSET 0x1800U
#define CPU_CTRL_HALT   0x00010001U
#define CPU_CTRL_START  0x00010000U

/*
 * The scratch registers are the only thing visible from the host while this
 * runs, and the harness prints them on every poll. Publishing the step means a
 * run that stops responding names where it stopped instead of just failing to
 * finish.
 */
#define STEP(step)       WRITE_SCRATCH(3, 0xB1000000U | (step))
#define STEP_RESULT(val) WRITE_SCRATCH(4, (uint32_t)(val))

/*
 * A die that owns two tiles publishes each one separately, into scratch[4] and
 * scratch[6], so a link that stalls can be told from the one beside it that
 * did not. scratch[5] is the chip id and stays out of the way.
 */
#define STEP_RESULT_TILE(tile, val) WRITE_SCRATCH(4 + ((tile) * 2), (uint32_t)(val))

static const struct link_tile *link_tiles;
static size_t link_count;
static uint32_t chip_id;

static const struct link_tile *link_tiles_for(uint32_t id, size_t *count)
{
#if defined(CONFIG_SOC_TT_KERAUNOS_SMC)
	if (id == CHIP_ID_KERAUNOS0) {
		*count = ARRAY_SIZE(tiles_keraunos0);
		return tiles_keraunos0;
	}
#else
	if (id == CHIP_ID_MIMIR0) {
		*count = ARRAY_SIZE(tiles_mimir0);
		return tiles_mimir0;
	}

	if (id == CHIP_ID_MIMIR1) {
		*count = ARRAY_SIZE(tiles_mimir1);
		return tiles_mimir1;
	}
#endif

	*count = 0;
	return NULL;
}

/*
 * Watching for the host's release directly, rather than folding it into the
 * wait for the link, so the two cannot be confused: a Rocket that was never
 * released and a Rocket that ran and failed to train look identical from the
 * link status register alone.
 *
 * The host releases every Rocket in one pass, so a die with two of them waits
 * for the last to move rather than treating them separately.
 */
static int wait_for_release(void)
{
	k_timepoint_t deadline = sys_timepoint_calc(RELEASE_TIMEOUT);

	do {
		size_t running = 0;

		for (size_t i = 0; i < link_count; i++) {
			if (sys_read32(link_tiles[i].base + CPU_CTRL_OFFSET) == CPU_CTRL_START) {
				running++;
			}
		}

		if (running == link_count) {
			return 0;
		}

		k_msleep(1);
	} while (!sys_timepoint_expired(deadline));

	return -ETIMEDOUT;
}

static void *train_setup(void)
{
	chip_id = READ_SCRATCH(15) & CHIP_ID_MASK;
	WRITE_SCRATCH(5, chip_id);

	STEP(1);
	for (size_t i = 0; i < ARRAY_SIZE(chip_tiles); i++) {
		zassert_true(device_is_ready(chip_tiles[i].dev), "%s not ready",
			     chip_tiles[i].dev->name);
	}

	/*
	 * Guessing would be worse than stopping. Bringing up a tile that faces
	 * a neighbour this package does not have fails in exactly the way a
	 * genuine training failure does, so an unset chip id has to be called
	 * out here rather than left to look like a dead link.
	 */
	STEP(2);
	link_tiles = link_tiles_for(chip_id, &link_count);
	zassert_not_null(link_tiles,
			 "scratch[15] low byte is 0x%02x, which is not a die this image knows "
			 "how to be; the harness has not identified this die",
			 chip_id);

	STEP(3);
	zassert_ok(tt_d2d_test_chip_init(), "chip init failed");

	/*
	 * Every tile the die has comes out of reset, not just the ones that
	 * get trained: a tile samples its straps at whatever rate is running
	 * at the time, and the clock switch below ends that window for all of
	 * them at once.
	 */
	STEP(4);
	for (size_t i = 0; i < ARRAY_SIZE(chip_tiles); i++) {
		zassert_ok(tt_d2d_reset_release(chip_tiles[i].dev), "%s reset release failed",
			   chip_tiles[i].dev->name);
	}

	/*
	 * The firmware brings up its PLL against the CCE clock and reports a
	 * lock failure if it is still running off the reference, so this has
	 * to happen before the image is loaded rather than after.
	 */
	STEP(5);
	zassert_ok(tt_d2d_test_chip_clock_up(), "clock switch failed");

	/*
	 * Mimir0 only: point the SMN sideband manager's D2D-select mux at D2D1
	 * so SMC-originated traffic leaves on the tile that faces Mimir1.
	 * Clearing before setting is what the drop does; the flag-out is level
	 * sensitive and may already be set.
	 *
	 * Mimir1 and Keraunos0 are left alone. The mux picks one tile, which
	 * is no use to the die that owns both ends of two links, and the drop
	 * only programs it on Mimir0.
	 */
#if !defined(CONFIG_SOC_TT_KERAUNOS_SMC)
	if (chip_id == CHIP_ID_MIMIR0) {
		STEP(6);
		sys_write32(0x1, SMN_D2D_SELECT_CLR);
		sys_write32(0x1, SMN_D2D_SELECT_SET);
	}
#endif

	STEP(7);

	return NULL;
}

/*
 * One test, because the steps are not independent: there is nothing to check
 * about training except that it happened, and every step before it is setup
 * for the one after. Splitting them would just re-run the bring-up.
 */
ZTEST(tt_d2d_train, test_link_trains)
{
	const uint8_t *img;
	size_t size = 0;
	int ret;

#ifdef D2D_FW_STUB_UNIT
	/*
	 * The generated stand-in is ASCII, not instructions. Nothing will
	 * train against it, and a failure here would say nothing about the
	 * hardware. Build with -DD2D_FW_BIN pointing at the drop's image.
	 */
	ztest_test_skip();
#endif

	STEP(8);
	img = d2d_fw_image(&size);
	zassert_not_null(img, "no firmware image linked in");
	zassert_true(size > 0, "linked firmware image is empty");

	/*
	 * Every tile this die owns is loaded before any of them is handed
	 * over. The host releases all the Rockets in one pass, so a tile left
	 * unloaded at that point would start on whatever is in its SRAM.
	 */
	for (size_t i = 0; i < link_count; i++) {
		const struct link_tile *tile = &link_tiles[i];

		STEP(9);
		ret = tt_d2d_load_fw(tile->dev, img, size);
		STEP_RESULT_TILE(i, ret);
		zassert_ok(ret, "loading %s failed", tile->dev->name);

		STEP(10);
		zassert_equal(sys_read32(tile->base + CPU_CTRL_OFFSET), CPU_CTRL_HALT,
			      "%s should still be halted after a load", tile->dev->name);
	}

	/*
	 * Hand over to the host. It releases these Rockets and the far ones
	 * together once every die has got this far, which is the only way they
	 * come up close enough in time to train.
	 */
	STEP(11);
	WRITE_SCRATCH(0, TS_D2D_WAIT_TRAINING);

	STEP(12);
	zassert_ok(wait_for_release(),
		   "a Rocket on this die was never released. The host does that once every die "
		   "reports TS_D2D_WAIT_TRAINING, so either another die never got there or the "
		   "harness is not driving this run");

	/*
	 * From here the far die has to be doing the same thing, so a timeout
	 * is ambiguous on its own: this end may be fine and the other absent.
	 * That is what the progress code separates -- one that advanced and
	 * stopped is a link problem, one that never moved is this side's
	 * firmware not running at all.
	 *
	 * The wait is sliced so the code can be published as it changes rather
	 * than only once the outcome is known. Under emulation the kernel
	 * clock advances far slower than the wall clock the run is watched on,
	 * so a single wait long enough to be fair to the firmware is also long
	 * enough to be indistinguishable from a wedged core. Republishing each
	 * time round tells the two apart and shows training advancing.
	 *
	 * The tiles are waited on one after another rather than together. They
	 * are already training in parallel -- the Rockets were all released
	 * before any of this -- so the only cost is that the second tile's
	 * progress is published late, and in exchange a stall names the link
	 * it happened on.
	 */
	STEP(13);
	for (size_t i = 0; i < link_count; i++) {
		const struct link_tile *tile = &link_tiles[i];

		for (unsigned int slice = 0; slice < TRAIN_SLICES; slice++) {
			ret = tt_d2d_wait_link(tile->dev, TRAIN_SLICE);
			STEP_RESULT_TILE(i, tt_d2d_progress_code(tile->dev));
			if (ret != -ETIMEDOUT) {
				break;
			}
		}

		zassert_ok(ret,
			   "%s did not train. Check that the die on the other end of it booted "
			   "and reached this point too; neither end can train alone",
			   tile->dev->name);
	}

	/*
	 * Nothing is written here on success: ztest's end-of-run report puts
	 * TS_PASS in scratch[0], which is the token the harness is waiting for.
	 */
	STEP(14);
}

/*
 * A passing run ends with TS_PASS in scratch[0], written by Grendel's
 * TC_END_REPORT override. A failing one writes nothing, which would leave
 * TS_D2D_WAIT_TRAINING sitting there -- the host would go on believing this
 * die is still waiting to be released and poll until it gave up, turning a
 * failure that is already understood into a timeout. Saying so explicitly
 * ends the run on both dies with a verdict instead.
 */
static void train_teardown(void *fixture)
{
	ARG_UNUSED(fixture);

	for (struct ztest_unit_test *t = _ztest_unit_test_list_start; t < _ztest_unit_test_list_end;
	     t++) {
		if (t->stats->fail_count != 0) {
			WRITE_SCRATCH(0, TS_FAIL);
			return;
		}
	}
}

ZTEST_SUITE(tt_d2d_train, NULL, train_setup, NULL, NULL, train_teardown);
```
