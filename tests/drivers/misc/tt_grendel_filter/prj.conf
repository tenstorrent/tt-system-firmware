## CMakeLists.txt
```
# SPDX-License-Identifier: Apache-2.0

cmake_minimum_required(VERSION 3.20.0)
find_package(Zephyr REQUIRED HINTS $ENV{ZEPHYR_BASE})
project(tt_grendel_filter)

set(SIVAL_BLOBS_TARBALL ${CMAKE_CURRENT_SOURCE_DIR}/../../../../zephyr/blobs/grendel-sival-sdk.tar.gz)
set(SYSFW_ROOT ${CMAKE_CURRENT_SOURCE_DIR}/../../../..)

include(${SYSFW_ROOT}/cmake/sival_sdk.cmake)
tt_sival_sdk_extract(${SIVAL_BLOBS_TARBALL})
set(SIVAL_SDK ${SIVAL_EXTDIR}/grendel_sival_sdk)

target_compile_definitions(app PRIVATE PLATFORM_KER_SMC=1)

# Stub regs.h must win over SiVal regs.h.
target_include_directories(app BEFORE PRIVATE ${CMAKE_CURRENT_SOURCE_DIR}/src)
target_include_directories(app PRIVATE
  ${SIVAL_EXTDIR}
  ${SIVAL_SDK}/common/include
  ${SIVAL_SDK}/common/include/registers
  ${SIVAL_SDK}/common/include/registers/common
  ${SIVAL_SDK}/common/include/registers/ker
  ${SIVAL_SDK}/firmware/common/include
  ${SIVAL_SDK}/firmware/drivers/firewall/include
)

target_sources(app PRIVATE
  src/main.c
  ${SYSFW_ROOT}/drivers/misc/tt_grendel_filter/tt_grendel_filter.c
  ${SIVAL_SDK}/firmware/drivers/firewall/src/firewall.c
)

set(TT_FORCE_REG_STUB
  ${SYSFW_ROOT}/drivers/misc/tt_grendel_filter/tt_grendel_filter.c
  ${SIVAL_SDK}/firmware/drivers/firewall/src/firewall.c
)
set_property(SOURCE ${TT_FORCE_REG_STUB} APPEND PROPERTY COMPILE_OPTIONS
  -include ${CMAKE_CURRENT_SOURCE_DIR}/src/regs.h
)
```

## prj.conf
```kconfig
CONFIG_ZTEST=y
CONFIG_GRENDEL_FILTER_INIT=y
```

## src/main.c
```c
/*
 * Copyright (c) 2026 Tenstorrent AI ULC
 *
 * SPDX-License-Identifier: Apache-2.0
 */

#include <errno.h>
#include <string.h>

#include <zephyr/drivers/misc/tt_grendel_filter.h>
#include <zephyr/sys/util.h>
#include <zephyr/ztest.h>

#include <firewall.h>
#include <platform.h>

#include "regs.h"

DEFINE_FFF_GLOBALS;

DEFINE_FAKE_VOID_FUNC(write16_reg, uint64_t, uint16_t);
DEFINE_FAKE_VALUE_FUNC(uint16_t, read16_reg, uint64_t);
DEFINE_FAKE_VOID_FUNC(write32_reg, uint64_t, uint32_t);
DEFINE_FAKE_VALUE_FUNC(uint32_t, read32_reg, uint64_t);
DEFINE_FAKE_VOID_FUNC(write64_reg, uint64_t, uint64_t);
DEFINE_FAKE_VALUE_FUNC(uint64_t, read64_reg, uint64_t);

#define FILTER_STRIDE        FIREWALL_FILTER_SIZE
#define FILTER_CONFIG_OFFSET FIREWALL_FILTER_CONFIG_OFFSET
#define FILTER_START_OFFSET  FIREWALL_START_ADDR_OFFSET
#define FILTER_END_OFFSET    FIREWALL_END_ADDR_OFFSET
#define INBOUND_BASE         SMC_CPU_SMC_INBOUND_FILTER_CTRL_0_REG_MAP_BASE_ADDR

#define FILTER_CONFIG_READ_EN     BIT64(0)
#define FILTER_CONFIG_WRITE_EN    BIT64(1)
#define FILTER_CONFIG_ADDR_MODE   BIT64(4)
#define FILTER_CONFIG_ALLOW_NS    BIT64(8)
#define FILTER_CONFIG_ALLOW_BURST BIT64(24)

static uint64_t entry_reg_addr(uint32_t entry, size_t offset)
{
	return INBOUND_BASE + (entry * FILTER_STRIDE) + offset;
}

static void assert_write64(uint64_t addr, uint64_t value)
{
	for (unsigned int i = write64_reg_fake.call_count; i > 0; i--) {
		unsigned int index = i - 1;

		if (write64_reg_fake.arg0_history[index] == addr) {
			zassert_equal(write64_reg_fake.arg1_history[index], value);
			return;
		}
	}

	zassert_true(false, "Expected write to 0x%llx", addr);
}

static void before(void *f)
{
	ARG_UNUSED(f);
	RESET_FAKE(write16_reg);
	RESET_FAKE(read16_reg);
	RESET_FAKE(write32_reg);
	RESET_FAKE(read32_reg);
	RESET_FAKE(write64_reg);
	RESET_FAKE(read64_reg);
}

ZTEST(tt_grendel_filter, test_enable_programs_entry)
{
	struct tt_grendel_filter_flags flags = {
		.read = 1,
		.write = 1,
		.nonsecure = 1,
		.burst = 1,
	};
	int ret = tt_grendel_filter_enable(SMC_INBOUND, 0, 0, 0x08018000, 0x08037fff, flags);

	zassert_equal(ret, 0);
	zassert_equal(write64_reg_fake.call_count, 3);
	assert_write64(entry_reg_addr(0, FILTER_START_OFFSET), 0x08018000);
	assert_write64(entry_reg_addr(0, FILTER_END_OFFSET), 0x08037fff);
	assert_write64(entry_reg_addr(0, FILTER_CONFIG_OFFSET),
		       FILTER_CONFIG_READ_EN | FILTER_CONFIG_WRITE_EN | FILTER_CONFIG_ADDR_MODE |
			       FILTER_CONFIG_ALLOW_NS | FILTER_CONFIG_ALLOW_BURST);
}

ZTEST(tt_grendel_filter, test_enable_read_only)
{
	struct tt_grendel_filter_flags flags = {
		.read = 1,
	};
	int ret = tt_grendel_filter_enable(SMC_INBOUND, 0, 0, 0x1000, 0x1fff, flags);

	zassert_equal(ret, 0);
	zassert_equal(write64_reg_fake.call_count, 3);
	assert_write64(entry_reg_addr(0, FILTER_CONFIG_OFFSET),
		       FILTER_CONFIG_READ_EN | FILTER_CONFIG_ADDR_MODE);
}

ZTEST(tt_grendel_filter, test_enable_equal_range)
{
	struct tt_grendel_filter_flags flags = {
		.write = 1,
	};
	int ret = tt_grendel_filter_enable(SMC_INBOUND, 0, 0, 0x2000, 0x2000, flags);

	zassert_equal(ret, 0);
	zassert_equal(write64_reg_fake.call_count, 3);
	assert_write64(entry_reg_addr(0, FILTER_START_OFFSET), 0x2000);
	assert_write64(entry_reg_addr(0, FILTER_END_OFFSET), 0x2000);
}

ZTEST(tt_grendel_filter, test_enable_does_not_touch_other_entry)
{
	struct tt_grendel_filter_flags flags = {
		.read = 1,
		.write = 1,
	};
	int ret = tt_grendel_filter_enable(SMC_INBOUND, 0, 0, 0x0, 0xff, flags);

	zassert_equal(ret, 0);
	zassert_equal(write64_reg_fake.call_count, 3);
	for (unsigned int i = 0; i < write64_reg_fake.call_count; i++) {
		zassert_true(write64_reg_fake.arg0_history[i] >= INBOUND_BASE &&
			     write64_reg_fake.arg0_history[i] < INBOUND_BASE + FILTER_STRIDE);
	}
}

ZTEST(tt_grendel_filter, test_disable_clears_entry)
{
	struct tt_grendel_filter_flags flags = {
		.read = 1,
		.write = 1,
		.burst = 1,
	};
	int ret;

	ret = tt_grendel_filter_enable(SMC_INBOUND, 1, 0, 0x10, 0x1f, flags);
	zassert_equal(ret, 0);

	ret = tt_grendel_filter_disable(SMC_INBOUND, 1, 0);
	zassert_equal(ret, 0);
	zassert_equal(write64_reg_fake.call_count, 6);
	assert_write64(entry_reg_addr(1, FILTER_CONFIG_OFFSET), 0);
	assert_write64(entry_reg_addr(1, FILTER_START_OFFSET), 0);
	assert_write64(entry_reg_addr(1, FILTER_END_OFFSET), 0);
}

ZTEST(tt_grendel_filter, test_enable_rejects_bad_args)
{
	struct tt_grendel_filter_flags rw = {
		.read = 1,
		.write = 1,
	};
	struct tt_grendel_filter_flags none = {0};

	zassert_equal(tt_grendel_filter_enable(SMC_INBOUND, 16, 0, 0, 1, rw), -EINVAL);
	zassert_equal(tt_grendel_filter_enable(SMC_INBOUND, 0, 0, 0x20, 0x10, rw), -EINVAL);
	zassert_equal(tt_grendel_filter_enable(SMC_INBOUND, 0, 0, BIT64(56), BIT64(56), rw),
		      -EINVAL);
	zassert_equal(tt_grendel_filter_enable(SMC_INBOUND, 0, 0, 0, 1, none), -EINVAL);
	zassert_equal(write64_reg_fake.call_count, 0);
}

ZTEST(tt_grendel_filter, test_disable_rejects_bad_entry)
{
	zassert_equal(tt_grendel_filter_disable(SMC_INBOUND, 16, 0), -EINVAL);
	zassert_equal(write64_reg_fake.call_count, 0);
}

ZTEST_SUITE(tt_grendel_filter, NULL, NULL, before, NULL, NULL);
```

## src/reg_stub.c
```c
/*
 * Copyright (c) 2026 Tenstorrent AI ULC
 *
 * SPDX-License-Identifier: Apache-2.0
 */

#include "regs.h"

#include <stdbool.h>
#include <string.h>

#define REG_MAP_CELLS 64

struct reg_cell {
	uint64_t addr;
	uint64_t val;
	uint8_t width;
	bool used;
};

static struct reg_cell cells[REG_MAP_CELLS];

static struct reg_cell *find_cell(uint64_t addr, uint8_t width, bool alloc)
{
	int i;
	int free_i = -1;

	for (i = 0; i < REG_MAP_CELLS; i++) {
		if (cells[i].used && cells[i].addr == addr && cells[i].width == width) {
			return &cells[i];
		}
		if (!cells[i].used && free_i < 0) {
			free_i = i;
		}
	}

	if (!alloc || free_i < 0) {
		return NULL;
	}

	cells[free_i].addr = addr;
	cells[free_i].val = 0;
	cells[free_i].width = width;
	cells[free_i].used = true;
	return &cells[free_i];
}

void tt_grendel_reg_stub_reset(void)
{
	memset(cells, 0, sizeof(cells));
}

void write16_reg(uint64_t addr, uint16_t value)
{
	struct reg_cell *c = find_cell(addr, 2, true);

	if (c != NULL) {
		c->val = value;
	}
}

uint16_t read16_reg(uint64_t addr)
{
	struct reg_cell *c = find_cell(addr, 2, false);

	return c != NULL ? (uint16_t)c->val : 0;
}

void write32_reg(uint64_t addr, uint32_t value)
{
	struct reg_cell *c = find_cell(addr, 4, true);

	if (c != NULL) {
		c->val = value;
	}
}

uint32_t read32_reg(uint64_t addr)
{
	struct reg_cell *c = find_cell(addr, 4, false);

	return c != NULL ? (uint32_t)c->val : 0;
}

void write64_reg(uint64_t addr, uint64_t value)
{
	struct reg_cell *c = find_cell(addr, 8, true);

	if (c != NULL) {
		c->val = value;
	}
}

uint64_t read64_reg(uint64_t addr)
{
	struct reg_cell *c = find_cell(addr, 8, false);

	return c != NULL ? c->val : 0;
}
```

## src/regs.h
```c
/*
 * Copyright (c) 2026 Tenstorrent AI ULC
 *
 * SPDX-License-Identifier: Apache-2.0
 *
 * Test-only MMIO capture. Included ahead of SiVal regs.h.
 */

#ifndef REGS_H
#define REGS_H

#include <stdint.h>

#include <zephyr/fff.h>

DECLARE_FAKE_VOID_FUNC(write16_reg, uint64_t, uint16_t);
DECLARE_FAKE_VALUE_FUNC(uint16_t, read16_reg, uint64_t);
DECLARE_FAKE_VOID_FUNC(write32_reg, uint64_t, uint32_t);
DECLARE_FAKE_VALUE_FUNC(uint32_t, read32_reg, uint64_t);
DECLARE_FAKE_VOID_FUNC(write64_reg, uint64_t, uint64_t);
DECLARE_FAKE_VALUE_FUNC(uint64_t, read64_reg, uint64_t);

#endif /* REGS_H */
```

## src/sival_addrs.c
```c
/*
 * Copyright (c) 2026 Tenstorrent AI ULC
 *
 * SPDX-License-Identifier: Apache-2.0
 *
 * SiVal headers only. Do not include Zephyr from this file.
 */

#include "sival_addrs.h"

#include <firewall.h>
#include <platform.h>

uint64_t tt_sival_inbound_filter_base(void)
{
	return SMC_CPU_SMC_INBOUND_FILTER_CTRL_0_REG_MAP_BASE_ADDR;
}

uint32_t tt_sival_smc_inbound(void)
{
	return SMC_INBOUND;
}

uint32_t tt_sival_filter_stride(void)
{
	return FIREWALL_FILTER_SIZE;
}

uint32_t tt_sival_filter_config_offset(void)
{
	return FIREWALL_FILTER_CONFIG_OFFSET;
}

uint32_t tt_sival_filter_start_offset(void)
{
	return FIREWALL_START_ADDR_OFFSET;
}

uint32_t tt_sival_filter_end_offset(void)
{
	return FIREWALL_END_ADDR_OFFSET;
}
```

## src/sival_addrs.h
```c
/*
 * Copyright (c) 2026 Tenstorrent AI ULC
 *
 * SPDX-License-Identifier: Apache-2.0
 */

#ifndef TT_GRENDEL_FILTER_SIVAL_ADDRS_H_
#define TT_GRENDEL_FILTER_SIVAL_ADDRS_H_

#include <stdint.h>

uint64_t tt_sival_inbound_filter_base(void);
uint32_t tt_sival_smc_inbound(void);
uint32_t tt_sival_filter_stride(void);
uint32_t tt_sival_filter_config_offset(void);
uint32_t tt_sival_filter_start_offset(void);
uint32_t tt_sival_filter_end_offset(void);

#endif
```
