/*
 * Copyright (c) 2025-2026 Tenstorrent AI ULC
 * SPDX-License-Identifier: Apache-2.0
 */

#include <mem.h>

storage_partition: &storage {
	reg = <0x600000 DT_SIZE_K(32)>;
};

/* Raise CSM to 320KB: this test holds two TEST_AREA_SIZE (32KB) buffers */
&csm {
	reg = <0x10000000 0x50000>;
};
