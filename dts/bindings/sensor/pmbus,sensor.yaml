## dts/bindings/sensor/pmbus,sensor.yaml
```yaml
# Copyright (c) 2026 Tenstorrent AI ULC
# SPDX-License-Identifier: Apache-2.0

description: Generic PMBus sensor

compatible: "pmbus,sensor"

include: [sensor-device.yaml, base.yaml]

properties:
  reg:
    required: true
```

## dts/bindings/sensor/tenstorrent,dummy-sensor-emul.yaml
```yaml
# Copyright (c) 2026 Tenstorrent AI ULC
# SPDX-License-Identifier: Apache-2.0

description: Test-only dummy sensor used as a sensor phandle target in native_sim unit tests.

compatible: "tenstorrent,dummy-sensor-emul"

include: sensor-device.yaml

properties:
  force-init-fail:
    type: boolean
    description: |
      Test-only knob. When present on a dummy sensor instance, driver init
      returns an error so device_is_ready() is false.
```

## dts/bindings/serial/tenstorrent,vuart.yml
```yaml
# Copyright (c) 2024 Tenstorrent AI ULC
# SPDX-License-Identifier: Apache-2.0

compatible: "tenstorrent,vuart"

description: |
  Tenstorrent Virtual UART driver

  This virtual uart driver is typically used in uncached, shared memory environments. It uses an
  in-memory structure that includes

  1. metadata for identifying the virtual uart in memory, including
      - a magic number which may be polled to determine when the virtual uart is ready for use
      - a version number which may be used to determine binary compatibility
  2. transmit and receive buffer information, including
      - buffer capacity
      - head and tail indices
      - statistics for virtual uart performance analysis
  3. the transmit and receive buffers themselves

  Both the head and tail indices of the transmit and receive buffers are 32-bit up-counters that
  wrap around the 32-bit boundary. When empty, the head and the tail indices are equal. When full,
  the tail index - the head index is equal to the buffer capacity. This ensures that there is no
  ambiguity between an empty buffer and a full buffer.

  By convention, the transmit and receive are from the perspective of the local processor. From
  the perspective of the remote processor, transmit and receive buffers, as well as indices, are
  reversed.

  Default sizes of the transmit and receive buffers are chosen such that the size of metadata,
  buffer information, and the buffers themselves fit into 4096 bytes of memory, and are naturally
  aligned on a 4-byte boundary.

  The theory of operation is as follows:

  - The remote processor updates the head index of the transmit buffer and the tail index of the
    receive buffer.
  - The local processor updates the head index of the receive buffer and the tail index of the
    transmit buffer.
  - Accesses are atomic with respect to other threads on the same processor. The local and
    remote processors access independent indices, and indices are monotonically increasing,
    generally mitigating the need for locks.
  - Caching is disabled for the virtual uart memory region.

  At this time, interrupt support is limited to being used for testing purposes only. The virtual
  uart driver may be updated at a later time to support interrupt-driven operation.

include: uart-controller.yaml

properties:

  memory-region:
    type: phandle
    description: |
      Memory region holding the virtual UART descriptor and its buffers. When omitted, the
      descriptor is allocated in the .bss section of the running image, which means its
      contents are lost whenever a new image takes over the processor.

      Pointing several boot stages at the same fixed region allows console output to be
      carried across the handoffs between them. The region must be at least
      sizeof(struct tt_vuart) + tx-cap + rx-cap bytes large and must not overlap any region
      that is cleared or reused during boot.

  init-metadata:
    type: boolean
    description: |
      Initialize the descriptor metadata and discard any buffered data at driver init.

      This should be set on the earliest boot stage, which is responsible for putting the
      descriptor into a known state. Later boot stages leave it unset so that they adopt the
      descriptor published by the previous stage instead of resetting it.

  loopback:
    type: boolean
    description: |
      Enable loopback mode. When enabled, data transmitted by the virtual UART device is
      immediately received by the virtual UART device. Loopback mode is used exclusively for
      test purposes at this time.

  magic:
    type: int
    default: 0x775e21a1
    description: |
      Magic number with which to identify the virtual UART device in-memory and determine when the
      virtual uart device is ready for use.

      The default value is a hexadecimal representation of the string "TTSeRial".

  rx-cap:
    type: int
    default: 1024
    description: |
      Receive buffer capacity in bytes. This is the maximum amount of data that can be queued
      at one time for reception via the virtual UART device.

  tx-cap:
    type: int
    default: 3036
    description: |
      Transmit buffer capacity in bytes. This is the maximum amount of data that can be queued
      at one time for transmission via the virtual UART device.

  version:
    type: int
    required: true
    const: 0x00000000
    description: |
      Version number of the virtual UART device. This number may be used to determine binary
      compatibility. Fields of the version number are 8-bits each, and are organized
      (from MSB to LSB) as [INST, MAJOR, MINOR, PATCH].

      When reading version information via the in-memory data structure, the INST field is used to
      enumerate multiiple instances of the virtual UART device on the remote processor side.
      Otherwise, the INST field has no bearing on the version number and should be ignored.

      The version field shall be updated when the binary layout of the in-memory structure
      changes, when other semantic behaviour of the virtual UART device changes, or when
      new features are added.
```

## lib/tenstorrent/Kconfig
```kconfig
# Copyright (c) 2024 Tenstorrent AI ULC
# SPDX-License-Identifier: Apache-2.0

menu "Tenstorrent libraries"

# zephyr-keep-sorted-start
rsource "banner/Kconfig"
rsource "bh_arc/Kconfig"
rsource "bh_chip/Kconfig"
rsource "bindesc/Kconfig"
rsource "bist/Kconfig"
rsource "boot_fs/Kconfig"
rsource "event/Kconfig"
rsource "fw_common/Kconfig"
rsource "gr_smc/Kconfig"
rsource "jtag_bootrom/Kconfig"
rsource "log_ringbuf/Kconfig"
rsource "log_tt_virt/Kconfig"
rsource "occp/Kconfig"
# zephyr-keep-sorted-stop

endmenu
```

## lib/tenstorrent/bh_arc/Kconfig.pcie_ltssm_log
```kconfig
# Copyright (c) 2026 Tenstorrent AI ULC
# SPDX-License-Identifier: Apache-2.0

config TT_BH_ARC_PCIE_LTSSM_LOG
	bool "PCIe LTSSM training log"
	depends on !TT_SMC_RECOVERY
	help
	  Debug only: log PCIe LTSSM transitions from a low-priority thread into
	  a CSM ring published in scratch registers 24/25 for the host to read.

if TT_BH_ARC_PCIE_LTSSM_LOG

config TT_BH_ARC_PCIE_LTSSM_LOG_ENTRIES
	int "LTSSM log capacity in entries"
	default 4096
	range 8 8192
	help
	  Ring capacity shared by both PCIe instances, 24 bytes of CSM per entry.
	  8192 is the most CSM-APP can hold.

config TT_BH_ARC_PCIE_LTSSM_LOG_CDR
	bool "Also log per-lane CDR lock"
	help
	  Also log per-lane CDR lock once past Detect. Costs a NOC read per lane
	  per pass, which lowers LTSSM edge resolution; uses NOC2AXI TLBs 7 and 8.

config TT_BH_ARC_PCIE_LTSSM_LOG_CDR_POLL_DIV
	int "Sample the PHY's CDR lock once every N passes"
	depends on TT_BH_ARC_PCIE_LTSSM_LOG_CDR
	default 1
	range 1 4096
	help
	  Raise to trade CDR timing resolution for LTSSM edge resolution.

endif # TT_BH_ARC_PCIE_LTSSM_LOG
```

## lib/tenstorrent/fw_bundle/Kconfig
```kconfig
# Copyright (c) 2026 Tenstorrent AI ULC
# SPDX-License-Identifier: Apache-2.0

config TT_FW_BUNDLE
	bool "Firmware bundle parser"
	help
	  Parse and authenticate Grendel BUN2 manifests and TOCs using the
	  on-wire structs in tt_bundle_loader.h. Does not program hardware.
```

## lib/tenstorrent/fw_common/Kconfig
```kconfig
# Copyright (c) 2026 Tenstorrent AI ULC
# SPDX-License-Identifier: Apache-2.0

config TT_FW_COMMON
	bool "Tenstorrent common firmware library"
	help
	  Portable firmware helpers shared across Tenstorrent SMC products
	  (e.g. Blackhole and Grendel).

if TT_FW_COMMON

config TT_FW_COMMON_EMUL
	bool "fw_common MMIO emulation"
	default y if BOARD_NATIVE_SIM
	help
	  Provide non-inline ReadReg/WriteReg stubs (reg_stub.c) for
	  host/native builds. Selected by TT_BH_ARC_EMUL when Blackhole
	  ARC emulation is enabled.

config TT_MSGQUEUE
	bool "Enable host message queue"
	default y
	select MBOX if DT_HAS_TENSTORRENT_MSGQUEUE_MBOX_ENABLED
	help
	  Enable the portable SMC host message queue implementation.
	  When a tenstorrent,msgqueue-mbox node is present, the mbox
	  IRQ doorbell backend is used instead of Blackhole MSI.

config TT_TELEMETRY
	bool "Telemetry core"
	default y if TT_BH_ARC || TT_GR_SMC
	help
	  Telemetry tag accessors and periodic update, shared across SoCs. Requires a
	  per-SoC implementation of telemetry_platform.h.

config TT_TELEMETRY_PERIODIC
	bool "Periodic telemetry update"
	depends on TT_TELEMETRY
	default y if BH_FWTABLE || TT_GR_SMC

config TT_MSGQUEUE_NUM_MSG_CODES
	int "Number of message codes"
	default 200
	depends on TT_MSGQUEUE
	help
	  Size of the message handler table (message code range).

endif
```

## lib/tenstorrent/gr_smc/Kconfig
```kconfig
# Copyright (c) 2026 Tenstorrent AI ULC
# SPDX-License-Identifier: Apache-2.0

config TT_GR_SMC
	bool "Grendel SMC support library"
	select SIVAL_SDK
	help
	  Enable Tenstorrent Grendel SMC support library components.

config TT_GR_SMC_ERR_STR
	bool "Grendel SMC error-string table (Sival SDK err.c)"
	select TT_GR_SMC
	default n
	help
	  Compile grendel_err_to_str from the grendel-sival-sdk tarball's
	  common/src/err.c

config TT_GR_SMC_AVS
	bool "Grendel SMC AVSBus voltage regulator telemetry"
	depends on TT_GR_SMC && TT_TELEMETRY
	default y if SOC_TT_KERAUNOS_SMC
	help
	  Read the core rail voltage, current and temperature from the board
	  voltage regulator over the SMC AVSBus controller and report them in
	  the VCORE, TDC, TDP and VREG_TEMPERATURE telemetry tags. The tags are
	  always present; without this option they read 0.

config TT_GR_SMC_LOG_BRIDGE
	bool "Grendel SMC log bridge"
	depends on LOG
	select TT_GR_SMC
	default n
	help
	  Provide strong log_message/log_with_location overrides for Grendel
	  firmware logging hooks and route them into Zephyr logging.

if TT_GR_SMC_LOG_BRIDGE

module = TT_GR_SMC_LOG_BRIDGE
module-str = Grendel SMC log bridge
source "subsys/logging/Kconfig.template.log_config"

endif # TT_GR_SMC_LOG_BRIDGE
```

## lib/tenstorrent/occp/Kconfig
```kconfig
# Copyright (c) 2026 Tenstorrent AI ULC
# SPDX-License-Identifier: Apache-2.0

config OCCP
	bool "OCCP Subsystem"
	select CRC # Required for header checksum calculations
	help
	  Enable support for the OCCP (Open Chiplet Configuration Protocol)
	  subsystem

if OCCP

choice OCCP_BACKEND
	prompt "OCCP Backend"
	default OCCP_BACKEND_I3C

config OCCP_BACKEND_I3C
	bool "I3C Backend"
	select I3C
	help
	  Use the I3C-based OCCP backend, which communicates with a remote
	  OCCP target over the I3C bus.

config OCCP_BACKEND_FAKE
	bool "Fake/loopback backend (for testing)"
	help
	  A software-only OCCP backend that simulates an OCCP device in memory.
	  For unit testing on native_sim only.

endchoice

config OCCP_RETRY_COUNT
	int "OCCP Retry Count"
	default 10
	help
	  Set the number of times to retry an OCCP command if it fails. This can help
	  improve reliability in the presence of transient errors, but may increase
	  latency.

config OCCP_RETRY_DELAY_MS
	int "OCCP Retry Delay (ms)"
	default 100
	help
	  Set the delay between OCCP command retries in milliseconds. This can help
	  improve reliability by giving the system time to recover from transient errors,
	  but may increase latency.

if OCCP_BACKEND_I3C

config OCCP_I3C_READ_TIMEOUT_MS
	int "OCCP I3C Read Timeout (ms)"
	default 5000
	help
	  Set the timeout for I3C read operations in the OCCP I3C backend. If a read
	  operation takes longer than this value, it will be aborted and an error will
	  be returned.
	  Note this timeout is currently very long to support running in
	  simulation environments

endif # OCCP_BACKEND_I3C

module = OCCP
module-str = occp
source "subsys/logging/Kconfig.template.log_config"

endif # OCCP
```

## lib/tenstorrent/sep_bl1/Kconfig
```kconfig
# Copyright (c) 2026 Tenstorrent AI ULC
# SPDX-License-Identifier: Apache-2.0

config TT_SEP_BL1
	bool "SEP BL1 boot services"
	help
	  Unsecured SEP BL1 path: stage the BUN1 SEP BL0 loaded for SMC BL0P5,
	  load and start BL0P5, and acknowledge its BUN2 validation doorbell.
	  MMIO and status reporting are supplied by platform ops.
```

## lib/tenstorrent/usb_shell/Kconfig
```kconfig
# Copyright (c) 2026 Tenstorrent AI ULC
# SPDX-License-Identifier: Apache-2.0

config TT_USB_SHELL
	bool "Second shell on USB CDC ACM"
	depends on SHELL_BACKEND_SERIAL
	depends on USBD_CDC_ACM_CLASS
	help
	  Run a second shell instance on the CDC ACM node the usb-shell alias
	  points at, alongside the shell on zephyr,shell-uart. Logging stays on
	  the serial shell.
```

## soc/tenstorrent/tt_grendel/Kconfig.soc
```kconfig
# Copyright (c) 2025 Tenstorrent AI ULC
# SPDX-License-Identifier: Apache-2.0

config SOC_FAMILY_TT_GRENDEL
	bool

config SOC_FAMILY
	default "tt_grendel" if SOC_FAMILY_TT_GRENDEL

rsource "*/Kconfig.soc"

config SIVAL_SDK
	bool
	default y if SOC_TT_KERAUNOS_SMC
	help
	  Indicates we are building with the SiVal SDK (tarball currently not in tree).
	  For source files using the definitions in the SiVal "sources" tarball, we
	  map SDK definitions to those present in "Sources" so that the code can
	  compile with either header. See tt_grendel_shim.h
```

## soc/tenstorrent/tt_grendel/tt_grendel_sep/Kconfig
```kconfig
# Copyright (c) 2026 Tenstorrent AI ULC
# SPDX-License-Identifier: Apache-2.0

config TT_GRENDEL_SEP
	select ARC
	select CPU_EM4
```

## soc/tenstorrent/tt_grendel/tt_grendel_sep/Kconfig.defconfig
```kconfig
# Copyright (c) 2026 Tenstorrent AI ULC
# SPDX-License-Identifier: Apache-2.0

if TT_GRENDEL_SEP

config SYS_CLOCK_HW_CYCLES_PER_SEC
	default 800000

config MP_MAX_NUM_CPUS
	default 1

config SYS_CLOCK_EXISTS
	default n

config NUM_IRQS
	default 32

# BL1 executes from ICCM SRAM with its data in DCCM.
config HARVARD
	default y

config RGF_NUM_BANKS
	default 1

config ARC_FIRQ
	default n

config CACHE_MANAGEMENT
	default n

endif # TT_GRENDEL_SEP
```

## soc/tenstorrent/tt_grendel/tt_grendel_sep/Kconfig.soc
```kconfig
# Copyright (c) 2026 Tenstorrent AI ULC
# SPDX-License-Identifier: Apache-2.0

config TT_GRENDEL_SEP
	bool
	help
	  Tenstorrent Grendel SEP cluster.
```

## soc/tenstorrent/tt_grendel/tt_grendel_smc/Kconfig
```kconfig
# Copyright (c) 2025 Tenstorrent AI ULC
# SPDX-License-Identifier: Apache-2.0

config TT_GRENDEL_SMC
	select RISCV
	select RISCV_PRIVILEGED
	select RISCV_HAS_PLIC
	select 64BIT
	select RISCV_SOC_HAS_GP_RELATIVE_ADDRESSING

	# Zephyr approximation of rv64imafdczicond_zicsr_zifencei_zihpm_xrocket
	# Note: we do not (yet) include Kconfig support for zicond, zihpm, or xrocket
	select RISCV_ISA_RV64I
	select RISCV_ISA_EXT_C
	select RISCV_ISA_EXT_G
	select CPU_HAS_FPU
	select CPU_HAS_FPU_DOUBLE_PRECISION
	# select RISCV_ISA_EXT_XROCKET
	# select RISCV_ISA_EXT_ZICOND
	select RISCV_ISA_EXT_ZICSR
	# select RISCV_ISA_EXT_ZIHPM

	select ATOMIC_OPERATIONS_BUILTIN
	select INCLUDE_RESET_VECTOR
	select SOC_EARLY_INIT_HOOK
	help
	  Tenstorrent Grendel System Management Core. This Kconfig should
	  be selected for all flavors of the Grendel SMC SoC.
```
