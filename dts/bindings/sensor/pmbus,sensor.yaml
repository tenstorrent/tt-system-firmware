## soc/tenstorrent/tt_grendel/tt_keraunos/Kconfig.soc
```kconfig
# Copyright (c) 2026 Tenstorrent AI ULC
# SPDX-License-Identifier: Apache-2.0

# Keraunos SMC quad-core RISC-V based on tenstorrent-rocketcore
config SOC_TT_KERAUNOS_SMC
	bool
	select SOC_FAMILY_TT_GRENDEL
	select TT_GRENDEL_SMC
	help
	  Tenstorrent KERAUNOS System Management Controller (SMC)

config SOC_TT_KERAUNOS_SEP
	bool
	select SOC_FAMILY_TT_GRENDEL
	select TT_GRENDEL_SEP
	help
	  Tenstorrent KERAUNOS Secure Enclave Processor (SEP)

config SOC
	default "tt_keraunos" if SOC_TT_KERAUNOS_SMC
	default "tt_keraunos" if SOC_TT_KERAUNOS_SEP
```

## test-conf/samples/hello_world/sample.yaml
```yaml
sample:
  description: Hello World sample, the simplest Zephyr
    application
  name: hello world
common:
  tags:
    - introduction
    - smoke
  integration_platforms:
    - native_sim
  harness: console
  harness_config:
    type: one_line
    regex:
      - "Hello World! (.*)"
tests:
  sample.basic.helloworld.rtt:
    filter: CONFIG_USE_SEGGER_RTT
    tags:
      - rtt
  sample.basic.helloworld.grendel:
    platform_allow:
      - tt_mimir/tt_mimir/smc
      - tt_mmk/tt_keraunos/sep
```

## test-conf/tests/drivers/dma/scatter_gather/testcase.yaml
```yaml
common:
  tags:
    - smoke
    - dma
  extra_configs:
    - CONFIG_TT_MSGQUEUE=n
tests:
  drivers.dma.scatter_gather.tt_mimir_smc:
    platform_allow:
      - tt_mimir/tt_mimir/smc
      - tt_mmk/tt_keraunos/smc
      - tt_mmk/tt_mimir/smc
      - tt_qsr1a1/tt_keraunos/smc
      - tt_qsr1a1/tt_mimir/smc
      - tt_qsr1a1/tt_quasar/smc
    extra_args:
      - "DTC_OVERLAY_FILE=\
         ../../../../../tt-system-firmware/test-conf/tests/drivers/dma/scatter_gather/\
         tt_grendel.overlay"
      - "EXTRA_CONF_FILE=\
         ../../../../../tt-system-firmware/test-conf/tests/drivers/dma/scatter_gather/\
         tt_grendel.conf"
  drivers.dma.scatter_gather.tt_bh_noc:
    platform_allow:
      - tt_blackhole@p100a/tt_blackhole/smc
      - tt_blackhole@p150a/tt_blackhole/smc
      - tt_blackhole@p150b/tt_blackhole/smc
      - tt_blackhole@p300a/tt_blackhole/smc
    extra_args:
      - "DTC_OVERLAY_FILE=\
         ../../../../../tt-system-firmware/test-conf/tests/drivers/dma/scatter_gather/\
         tt_bh_noc.overlay"
      - "EXTRA_CONF_FILE=\
         ../../../../../tt-system-firmware/test-conf/tests/drivers/dma/scatter_gather/\
         tt_bh_noc.conf"
  drivers.dma.scatter_gather.arc_hs.interrupts:
    platform_allow:
      - tt_blackhole@p100a/tt_blackhole/smc
      - tt_blackhole@p150a/tt_blackhole/smc
      - tt_blackhole@p150b/tt_blackhole/smc
      - tt_blackhole@p300a/tt_blackhole/smc
    extra_args:
      - "DTC_OVERLAY_FILE=\
         ../../../../../tt-system-firmware/test-conf/tests/drivers/dma/scatter_gather/\
         arc_hs.overlay"
      - "EXTRA_CONF_FILE=\
         ../../../../../tt-system-firmware/test-conf/tests/drivers/dma/scatter_gather/\
         arc_hs.conf"
  drivers.dma.scatter_gather.arc_hs.polling:
    platform_allow:
      - tt_blackhole@p100a/tt_blackhole/smc
      - tt_blackhole@p150a/tt_blackhole/smc
      - tt_blackhole@p150b/tt_blackhole/smc
      - tt_blackhole@p300a/tt_blackhole/smc
    extra_args:
      - "DTC_OVERLAY_FILE=\
         ../../../../../tt-system-firmware/test-conf/tests/drivers/dma/scatter_gather/\
         arc_hs_polling.overlay"
      - "EXTRA_CONF_FILE=\
         ../../../../../tt-system-firmware/test-conf/tests/drivers/dma/scatter_gather/\
         arc_hs.conf"
```

## test-conf/tests/drivers/mbox/mbox_data/testcase.yaml
```yaml
tests:
  drivers.mbox.mbox_data.grendel:
    tags: smoke
    platform_allow:
      - tt_mimir/tt_mimir/smc
      - tt_mmk/tt_mimir/smc
      - tt_mmk/tt_keraunos/smc
      - tt_qsr1a1/tt_keraunos/smc
      - tt_qsr1a1/tt_mimir/smc
      - tt_qsr1a1/tt_quasar/smc
    extra_args:
      - "DTC_OVERLAY_FILE=\
        ../../../../../tt-system-firmware/test-conf/tests/drivers/mbox/mbox_data/\
        boards/grendel_smc.overlay"
      - "CONF_FILE=\
        ../../../../../tt-system-firmware/test-conf/tests/drivers/mbox/mbox_data/\
        boards/grendel_smc.conf"
```

## test-conf/tests/drivers/uart/uart_elementary/testcase.yaml
```yaml
tests:
  drivers.uart.uart_elementary.uart_tt_virt:
    tags: tt_sim
    filter: CONFIG_SERIAL_SUPPORT_INTERRUPT
    platform_allow:
      - native_sim/native/64
    extra_args:
      - "DTC_OVERLAY_FILE=\
        ../../../../../tt-system-firmware/test-conf/tests/drivers/uart/uart_elementary/\
        uart_tt_virt.overlay"
      - "CONF_FILE=\
        ../../../../../tt-system-firmware/test-conf/tests/drivers/uart/uart_elementary/\
        uart_tt_virt.conf"
  drivers.uart.uart_elementary.grendel_uart:
    tags: smoke
    platform_allow:
      - tt_mimir/tt_mimir/smc
    extra_args:
      - "DTC_OVERLAY_FILE=\
        ../../../../../tt-system-firmware/test-conf/tests/drivers/uart/uart_elementary/\
        tt_mimir_tt_mimir_smc.overlay"
      - "CONF_FILE=\
        ../../../../../tt-system-firmware/test-conf/tests/drivers/uart/uart_elementary/\
        tt_mimir_tt_mimir_smc.conf"
  drivers.uart.uart_elementary.grendel_uart.tt_mmk:
    tags: smoke
    platform_allow:
      - tt_mmk/tt_keraunos/smc
      - tt_mmk/tt_mimir/smc
    extra_args:
      - "DTC_OVERLAY_FILE=\
        ../../../../../tt-system-firmware/test-conf/tests/drivers/uart/uart_elementary/\
        tt_mmk_smc.overlay"
      - "CONF_FILE=\
        ../../../../../tt-system-firmware/test-conf/tests/drivers/uart/uart_elementary/\
        tt_mmk_smc.conf"
```

## tests/boards/tenstorrent/tt_blackhole/dmc/gpiox/testcase.yaml
```yaml
tests:
  boards.tenstorrent.tt_blackhole.bmc.gpiox:
    tags:
      - i2c
      - gpio
      - smoke
    filter: dt_compat_enabled("nxp,pca9554") or dt_compat_enabled("nxp,pca9555")
    platform_exclude:
      - tt_mmk/tt_keraunos/smc
      - tt_mmk/tt_mimir/smc
      - tt_qsr1a1/tt_quasar/smc
      - tt_qsr1a1/tt_mimir/smc
      - tt_qsr1a1/tt_keraunos/smc
```

## tests/boards/tenstorrent/tt_blackhole/max6639/testcase.yaml
```yaml
tests:
  boards.tenstorrent.tt_blackhole.max6639:
    tags:
      - i2c
      - mfd
      - pwm
      - sensor
      - smoke
    filter: dt_compat_enabled("maxim,max6639")
    platform_exclude:
      - tt_mmk/tt_keraunos/smc
      - tt_mmk/tt_mimir/smc
      - tt_qsr1a1/tt_quasar/smc
      - tt_qsr1a1/tt_mimir/smc
      - tt_qsr1a1/tt_keraunos/smc
```

## tests/drivers/dma/all_chan_blen_transfer/testcase.yaml
```yaml
common:
  tags:
    - dma
    - smoke
tests:
  drivers.dma.all_chan_blen_transfer.arc_hs.interrupts:
    platform_allow:
      - tt_blackhole@p100a/tt_blackhole/smc
      - tt_blackhole@p150a/tt_blackhole/smc
      - tt_blackhole@p150b/tt_blackhole/smc
      - tt_blackhole@p300a/tt_blackhole/smc
    extra_dtc_overlay_files:
      - arc_hs.overlay
```
