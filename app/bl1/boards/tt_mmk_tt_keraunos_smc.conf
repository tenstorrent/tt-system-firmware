## app/bl1/boards/tt_mmk_tt_keraunos_smc.conf
```kconfig
# Copyright (c) 2026 Tenstorrent AI ULC
# SPDX-License-Identifier: Apache-2.0
CONFIG_I3C_CONTROLLER_ROLE_ONLY=y
CONFIG_I3C_USE_IBI=n
```

## app/mis/boards/tt_mmk_tt_mimir_smc.conf
```kconfig
CONFIG_SHELL_PROMPT_UART="tt_mimir:~$ "
CONFIG_I3C_TARGET_ROLE_ONLY=y
CONFIG_I3C=y
```

## app/smc/Kconfig.sysbuild
```kconfig
# Copyright (c) 2025 Tenstorrent AI ULC
#
# SPDX-License-Identifier: Apache-2.0

source "share/sysbuild/Kconfig"

config DMC_BOARD
	string "DMC Board"
	default "tt_blackhole@p150a/tt_blackhole/dmc" if $(BOARD_REVISION) = "p150a"
	default "tt_blackhole@p150b/tt_blackhole/dmc" if $(BOARD_REVISION) = "p150b"
	default "tt_blackhole@p150c/tt_blackhole/dmc" if $(BOARD_REVISION) = "p150c"
	default "tt_blackhole@p100a/tt_blackhole/dmc" if $(BOARD_REVISION) = "p100a"
	default "tt_blackhole@p300a/tt_blackhole/dmc" if $(BOARD_REVISION) = "p300a"
	default "tt_blackhole@p300b/tt_blackhole/dmc" if $(BOARD_REVISION) = "p300b"
	default "tt_blackhole@p300c/tt_blackhole/dmc" if $(BOARD_REVISION) = "p300c"
	default "tt_blackhole_glx2_dmc" if $(BOARD_REVISION) = "galaxy_2"
	default "tt_blackhole@orion_slt/tt_blackhole/dmc" if $(BOARD_REVISION) = "orion_slt"
```

## boards/tenstorrent/tt_blackhole/board.yml
```yaml
boards:
- name: tt_blackhole
  full_name: Tenstorrent Blackhole board
  vendor: tenstorrent
  revision:
    format: custom
    revisions:
    - name: "p100a"
    - name: "p150a"
    - name: "p150b"
    - name: "p150c"
    - name: "p300a"
    - name: "p300b"
    - name: "p300c"
    - name: "galaxy"
    - name: "galaxy_2"
    - name: "galaxy_revc"
    - name: "galaxy_bin6"
    - name: "orion_slt"
  socs:
  - name: tt_blackhole
```

## boards/tenstorrent/tt_blackhole_glx2_dmc/Kconfig.tt_blackhole_glx2_dmc
```kconfig
# Copyright (c) 2026 Tenstorrent AI ULC
# SPDX-License-Identifier: Apache-2.0

config BOARD_TT_BLACKHOLE_GLX2_DMC
	select SOC_STM32U375XX
```

## boards/tenstorrent/tt_blackhole_glx2_dmc/board.yml
```yaml
# Copyright (c) 2026 Tenstorrent AI ULC
# SPDX-License-Identifier: Apache-2.0

board:
  name: tt_blackhole_glx2_dmc
  full_name: Tenstorrent Blackhole GLX2 DMC board
  vendor: tenstorrent
  socs:
    - name: stm32u375xx
```

## boards/tenstorrent/tt_blackhole_glx2_dmc/tt_blackhole_glx2_dmc_defconfig
```kconfig
# Copyright (c) 2026 Tenstorrent AI ULC
# SPDX-License-Identifier: Apache-2.0

# Enable RTT
CONFIG_USE_SEGGER_RTT=y
CONFIG_SEGGER_RTT_BUFFER_SIZE_UP=3072

# enable console
CONFIG_CONSOLE=y
CONFIG_RTT_CONSOLE=y

# GPIO Controller
CONFIG_GPIO=y

# Enable Clocks
CONFIG_CLOCK_CONTROL=y

# enable i2c
CONFIG_I2C=y

# enable spi
CONFIG_SPI=y

# enable flash
CONFIG_FLASH=y

# enable external spi flash
CONFIG_SPI_NOR=y
CONFIG_SPI_NOR_FLASH_LAYOUT_PAGE_SIZE=4096
CONFIG_SPI_NOR_SFDP_RUNTIME=y

# interrupts are not needed for nxp,pca955x gpio expanders
CONFIG_GPIO_PCA_SERIES_INTERRUPT=n

# enable USB
#CONFIG_USB_DEVICE_STACK=y

# enable watchdog
CONFIG_WATCHDOG=y
```

## boards/tenstorrent/tt_mmk/Kconfig.tt_mmk
```kconfig
# Copyright (c) 2026 Tenstorrent AI ULC
# SPDX-License-Identifier: Apache-2.0

config BOARD_TT_MMK
	select SOC_TT_KERAUNOS_SMC if BOARD_TT_MMK_TT_KERAUNOS_SMC
	select SOC_TT_MIMIR_SMC if BOARD_TT_MMK_TT_MIMIR_SMC
	select SIVAL_SHIM if BOARD_TT_MMK_TT_MIMIR_SMC
```

## drivers/dma/Kconfig.tt_bh
```kconfig
# Copyright (c) 2025 Tenstorrent AI ULC
# SPDX-License-Identifier: Apache-2.0

config DMA_TT_BH_NOC
	bool "Tenstorrent Blackhole NOC DMA"
	default y
	depends on DT_HAS_TENSTORRENT_NOC_DMA_ENABLED
	help
		Enable the Tenstorrent Blackhole NOC DMA driver.

config DMA_TT_BH_NOC_ZTEST_COORDS_INIT
	bool "Set test DMA coords during ztest boot"
	depends on DMA_TT_BH_NOC && ZTEST
	default n
	help
		Enable a test-only init hook in the DMA driver that sets source/destination
		NOC coordinates on all DMA channels at boot. Routes from enabled Tensix
		back to ARC NOC0 (8,0).
```

## drivers/flash/Kconfig
```kconfig
#  Copyright (c) 2025 Tenstorrent AI ULC
#  SPDX-License-Identifier: Apache-2.0

if FLASH

menu "Flash drivers"

config FLASH_TT_MUX
	bool "Tenstorrent flash mux"
	default y
	depends on DT_HAS_TENSTORRENT_FLASH_MUX_ENABLED
	help
	  Support for the Tenstorrent flash mux driver. It selects among
	  several candidate flash devices at init - typically alternative
	  configurations of second-source chips on the same bus position -
	  and forwards all flash API calls to the selected one.

if FLASH_TT_MUX

config FLASH_TT_MUX_INIT_PRIORITY
	int "Tenstorrent flash mux init priority"
	default 85
	help
	  Init priority of the flash mux. Must be greater than the init
	  priority of the candidate flash devices, so that they have
	  probed by the time the mux selects among them, and less than
	  that of the first flash consumer.

endif

config FLASH_TT_STM32_WRAPPER
	bool "Tenstorrent STM32 Flash Wrapper"
	default y
	select SOC_FLASH_STM32
	depends on DT_HAS_TENSTORRENT_STM32_FLASH_WRAPPER_ENABLED
	help
	  Support for Tenstorrent STM32 Flash Wrapper driver.
	  This is a wrapper around the standard STM32 flash driver
	  that fakes the flash page size to 4KB for MCUs with 2K pages.

endmenu

endif
```

## drivers/memc/Kconfig
```kconfig
#  Copyright (c) 2026 Tenstorrent AI ULC
#  SPDX-License-Identifier: Apache-2.0

if MEMC

menu "Memory controller drivers"

# zephyr-keep-sorted-start
rsource "Kconfig.tt_mimir"
# zephyr-keep-sorted-stop

endmenu

endif
```

## drivers/memc/Kconfig.tt_mimir
```kconfig
# Copyright (c) 2026 Tenstorrent AI ULC
# SPDX-License-Identifier: Apache-2.0

config MEMC_TT_MIMIR
	bool "Tenstorrent Mimir GDDR7 Memory Controller"
	default n
	depends on DT_HAS_TENSTORRENT_MIMIR_MEMC_ENABLED
	select TT_GR_SMC_ERR_STR
	select TT_GR_SMC_LOG_BRIDGE
	select LOG
	help
	  Enable the Tenstorrent Mimir GDDR7 memory-controller driver.

if MEMC_TT_MIMIR

config MEMC_TT_MIMIR_INIT_PRIORITY
	int "Tenstorrent Mimir GDDR init priority"
	default 90
	help
	  Device init priority for the Mimir GDDR memc driver.

endif # MEMC_TT_MIMIR
```

## drivers/misc/tt_d2d/Kconfig
```kconfig
# Copyright (c) 2026 Tenstorrent AI ULC
# SPDX-License-Identifier: Apache-2.0

config TT_D2D
	bool "Tenstorrent Grendel D2D firmware loader"
	default y
	depends on DT_HAS_TENSTORRENT_GRENDEL_D2D_ENABLED
	help
	  Enable the die-to-die (D2D) firmware loader for Tenstorrent Grendel.
	  The driver writes a firmware image into a D2D tile's Rocket SRAM,
	  fills in the configuration block that firmware reads at startup, and
	  releases the Rocket to run it.

if TT_D2D

config TT_D2D_INIT_PRIO
	int
	default 75
	help
	  Initialization priority of the D2D driver. Nothing is touched at init
	  time, so this only has to leave the device available before any
	  application code that loads firmware into it.

config TT_D2D_VERIFY_LOAD
	bool "Read back the image after loading"
	default y
	help
	  Read the firmware image back out of D2D SRAM and compare it against
	  the source before releasing the Rocket. Catches a bad or unmapped
	  SRAM window as a load failure rather than as an unexplained failure
	  to train the link later on. Costs one extra read per word.

module = TT_D2D
module-str = tt_d2d
source "subsys/logging/Kconfig.template.log_config"

endif # TT_D2D
```

## drivers/misc/tt_grendel_filter/Kconfig
```kconfig
# Copyright (c) 2026 Tenstorrent AI ULC
# SPDX-License-Identifier: Apache-2.0

config TT_GRENDEL_FILTER
	bool "Grendel fabric filter (SiVal firewall wrapper)"
	depends on SOC_TT_KERAUNOS_SMC
	default y
	select LOG
	help
	  Wrap SiVal firewall.c and program SMC inbound host windows
	  (scratch, VUART, SEP-safe SRAM, BUN2 staging).

if TT_GRENDEL_FILTER

module = TT_GRENDEL_FILTER
module-str = tt_grendel_filter
source "subsys/logging/Kconfig.template.log_config"

endif # TT_GRENDEL_FILTER
```

## drivers/misc/tt_grendel_filters/Kconfig
```kconfig
# Copyright (c) 2026 Tenstorrent AI ULC
# SPDX-License-Identifier: Apache-2.0

if DT_HAS_TENSTORRENT_GRENDEL_AXI_FILTER_ENABLED

module = TT_GRENDEL_AXI_FILTER
module-str = tt_grendel_axi_filter
source "subsys/logging/Kconfig.template.log_config"

endif # DT_HAS_TENSTORRENT_GRENDEL_AXI_FILTER_ENABLED
```

## drivers/misc/tt_grendel_hsio/Kconfig
```kconfig
# Copyright (c) 2026 Tenstorrent AI ULC
# SPDX-License-Identifier: Apache-2.0

config TT_GRENDEL_HSIO
	bool "Grendel HSIO tile bring-up"
	depends on TT_GRENDEL_FILTER
	depends on TT_GRENDEL_PCIE
	default n
	select LOG
	help
	  Wrap SiVal HSIO clock/reset helpers and open HSIO/SMN firewalls
	  after PCIe init and SMC filter policy.

if TT_GRENDEL_HSIO

config TT_GRENDEL_HSIO_INIT_PRIORITY
	int "HSIO SYS_INIT priority (POST_KERNEL)"
	default 40
	help
	  Must run after the SMC filter POST_KERNEL hook (priority 0).

module = TT_GRENDEL_HSIO
module-str = tt_grendel_hsio
source "subsys/logging/Kconfig.template.log_config"

endif # TT_GRENDEL_HSIO
```

## drivers/misc/tt_grendel_i3c_controller/Kconfig
```kconfig
# Copyright (c) 2026 Tenstorrent AI ULC
# SPDX-License-Identifier: Apache-2.0

config TT_GRENDEL_I3C_CONTROLLER
	bool "Tenstorrent Grendel inter-die command controller over I3C"
	default y
	depends on DT_HAS_TENSTORRENT_GRENDEL_I3C_CONTROLLER_ENABLED
	select I3C
	help
	  Issue commands to a tenstorrent,grendel-i3c-target on the remote die
	  and wait for them to complete. Currently carries the D2D bring-up
	  commands, which let both ends of a D2D link be loaded and started
	  together.

if TT_GRENDEL_I3C_CONTROLLER

config TT_GRENDEL_I3C_CONTROLLER_INIT_PRIO
	int
	default 76
	help
	  Initialization priority of the Grendel I3C controller driver. Must be
	  higher than I3C_CONTROLLER_INIT_PRIORITY so the I3C bus is ready, and
	  lower than TT_MIMIR_REMOTE_BOOT_INIT_PRIO (77) so it is usable from
	  there.

module = TT_GRENDEL_I3C_CONTROLLER
module-str = tt_grendel_i3c_controller
source "subsys/logging/Kconfig.template.log_config"

endif # TT_GRENDEL_I3C_CONTROLLER
```

## drivers/misc/tt_grendel_i3c_target/Kconfig
```kconfig
# Copyright (c) 2026 Tenstorrent AI ULC
# SPDX-License-Identifier: Apache-2.0

config TT_GRENDEL_I3C_TARGET
	bool "Tenstorrent Grendel inter-die command target over I3C"
	default y
	depends on DT_HAS_TENSTORRENT_GRENDEL_I3C_TARGET_ENABLED
	depends on I3C_TARGET
	select TT_D2D
	help
	  Register as an I3C target and execute commands issued by the
	  controller die. Currently carries the D2D bring-up commands, which
	  let both ends of a D2D link be loaded and started together.

if TT_GRENDEL_I3C_TARGET

config TT_GRENDEL_I3C_TARGET_INIT_PRIO
	int
	default 80
	help
	  Initialization priority of the Grendel I3C target driver. Must be
	  higher than TT_D2D_INIT_PRIO (75) so the local D2D devices are ready,
	  and higher than I3C_CONTROLLER_INIT_PRIORITY so the bus exists.

module = TT_GRENDEL_I3C_TARGET
module-str = tt_grendel_i3c_target
source "subsys/logging/Kconfig.template.log_config"

endif # TT_GRENDEL_I3C_TARGET
```

## drivers/misc/tt_occp_i3c/Kconfig
```kconfig
# Copyright (c) 2026 Tenstorrent AI ULC
# SPDX-License-Identifier: Apache-2.0

config TT_OCCP_I3C
	bool "Tenstorrent OCCP I3C device driver"
	depends on I3C
	depends on OCCP_BACKEND_I3C
	help
	  Enable Tenstorrent OCCP I3C device driver.

	  This driver provides basic I3C device functionality and can be
	  extended to support OCCP (Open Compute Control Protocol) features.

if TT_OCCP_I3C

config TT_OCCP_I3C_INIT_PRIORITY
	int "TT OCCP I3C driver initialization priority"
	default 80
	help
	  Initialization priority for the TT OCCP I3C driver.
	  Must be greater than I3C controller initialization priority.

module = TT_OCCP_I3C
module-str = tt_occp_i3c
source "subsys/logging/Kconfig.template.log_config"

endif # TT_OCCP_I3C
```

## drivers/pcie/Kconfig
```kconfig
# Copyright (c) 2026 Tenstorrent AI ULC
# SPDX-License-Identifier: Apache-2.0

menu "Tenstorrent PCIe drivers"

config TT_GRENDEL_PCIE
	bool "Grendel Keraunos PCIe endpoint init (SiVal libdriver_pcie.a)"
	depends on SOC_TT_KERAUNOS_SMC
	depends on DT_HAS_TENSTORRENT_GRENDEL_PCIE_ENABLED
	default n
	select LOG
	help
	  Wrapper around SiVal libdriver_pcie.a. Does not use Zephyr
	  CONFIG_PCIE.

if TT_GRENDEL_PCIE

config TT_GRENDEL_PCIE_HW_INIT
	bool "Run SiVal PCIe bring-up in this image"
	default n
	help
	  When y, PRE_KERNEL_2 init runs the blocking SiVal state machine
	  (RESET through ENUM_READY). Enable in the image that trains the
	  link. Later images should leave this n so the device exists
	  without retraining a link already brought up. Device init still
	  verifies link status either way.

config TT_GRENDEL_PCIE_INIT_PRIORITY
	int "Grendel PCIe device init priority"
	default 50
	help
	  PRE_KERNEL_2 priority for the PCIe device.

module = TT_GRENDEL_PCIE
module-str = tt_grendel_pcie
source "${ZEPHYR_BASE}/subsys/logging/Kconfig.template.log_config"

endif # TT_GRENDEL_PCIE

endmenu
```
