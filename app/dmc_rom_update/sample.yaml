## lib/tenstorrent/boot_fs/Kconfig
```kconfig
# Copyright (c) 2024 Tenstorrent AI ULC
# SPDX-License-Identifier: Apache-2.0

config TT_BOOT_FS
	bool "Tenstorrent boot filesystem library"
	help
	  Library for interacting with the boot filesystem.

config TT_BOOT_FS_IMAGE_COUNT_MAX
	int "Maximum number of file descriptors"
	default 32
	depends on TT_BOOT_FS
```

## soc/tenstorrent/tt_blackhole/Kconfig
```kconfig
# Copyright (c) 2024 Tenstorrent AI ULC
# SPDX-License-Identifier: Apache-2.0

config SOC_TT_BLACKHOLE_DMC
	select ARM
	select CPU_CORTEX_M0PLUS
	select CPU_CORTEX_M_HAS_VTOR
	select CPU_HAS_ARM_MPU
	select CPU_CORTEX_M_HAS_SYSTICK
	select HAS_PM
	select SOC_EARLY_INIT_HOOK

config SOC_TT_BLACKHOLE_SMC
	select ARC
	select CPU_HAS_FPU
	select MULTI_LEVEL_INTERRUPTS
	select 2ND_LEVEL_INTERRUPTS
	select PINCTRL_STORE_REG if PINCTRL
	select HAS_SEGGER_RTT if ZEPHYR_SEGGER_MODULE
	select SOC_EARLY_INIT_HOOK
```

## test-conf/tests/drivers/dma/chan_blen_transfer/testcase.yaml
```yaml
common:
  tags:
    - smoke
    - dma
tests:
  drivers.dma.chan_blen_transfer.tt_mimir_smc:
    platform_allow:
      - tt_mimir/tt_mimir/smc
    extra_args:
      - "DTC_OVERLAY_FILE=\
         ../../../../../tt-system-firmware/test-conf/tests/drivers/dma/chan_blen_transfer/\
         tt_mimir_tt_mimir_smc.overlay"
      - "EXTRA_CONF_FILE=\
         ../../../../../tt-system-firmware/test-conf/tests/drivers/dma/chan_blen_transfer/\
         tt_mimir_tt_mimir_smc.conf"
  drivers.dma.chan_blen_transfer.tt_bh_noc:
    platform_allow:
      - tt_blackhole@p100a/tt_blackhole/smc
      - tt_blackhole@p150a/tt_blackhole/smc
      - tt_blackhole@p150b/tt_blackhole/smc
      - tt_blackhole@p300a/tt_blackhole/smc
    extra_args:
      - "DTC_OVERLAY_FILE=\
         ../../../../../tt-system-firmware/test-conf/tests/drivers/dma/chan_blen_transfer/\
         tt_bh_noc.overlay"
  drivers.dma.chan_blen_transfer.arc_hs.interrupts:
    platform_allow:
      - tt_blackhole@p100a/tt_blackhole/smc
      - tt_blackhole@p150a/tt_blackhole/smc
      - tt_blackhole@p150b/tt_blackhole/smc
      - tt_blackhole@p300a/tt_blackhole/smc
    extra_args:
      - "DTC_OVERLAY_FILE=\
         ../../../../../tt-system-firmware/test-conf/tests/drivers/dma/chan_blen_transfer/\
         arc_hs.overlay"
  drivers.dma.chan_blen_transfer.arc_hs.polling:
    platform_allow:
      - tt_blackhole@p100a/tt_blackhole/smc
      - tt_blackhole@p150a/tt_blackhole/smc
      - tt_blackhole@p150b/tt_blackhole/smc
      - tt_blackhole@p300a/tt_blackhole/smc
    extra_args:
      - "DTC_OVERLAY_FILE=\
         ../../../../../tt-system-firmware/test-conf/tests/drivers/dma/chan_blen_transfer/\
         arc_hs_polling.overlay"
```

## test-conf/tests/drivers/dma/chan_link_transfer/testcase.yaml
```yaml
common:
  tags:
    - smoke
    - dma
  platform_allow:
    - tt_blackhole@p100a/tt_blackhole/smc
    - tt_blackhole@p150a/tt_blackhole/smc
    - tt_blackhole@p150b/tt_blackhole/smc
    - tt_blackhole@p300a/tt_blackhole/smc
tests:
  drivers.dma.chan_link_transfer.tt_bh_noc:
    extra_args:
      - "DTC_OVERLAY_FILE=\
         ../../../../../tt-system-firmware/test-conf/tests/drivers/dma/chan_link_transfer/\
         tt_bh_noc.overlay"
      - "EXTRA_CONF_FILE=\
         ../../../../../tt-system-firmware/test-conf/tests/drivers/dma/chan_link_transfer/\
         tt_bh_noc.conf"
  drivers.dma.chan_link_transfer.arc_hs.interrupts:
    extra_args:
      - "DTC_OVERLAY_FILE=\
         ../../../../../tt-system-firmware/test-conf/tests/drivers/dma/chan_link_transfer/\
         arc_hs.overlay"
      - "EXTRA_CONF_FILE=\
         ../../../../../tt-system-firmware/test-conf/tests/drivers/dma/chan_link_transfer/\
         arc_hs.conf"
  drivers.dma.chan_link_transfer.arc_hs.polling:
    extra_args:
      - "DTC_OVERLAY_FILE=\
         ../../../../../tt-system-firmware/test-conf/tests/drivers/dma/chan_link_transfer/\
         arc_hs_polling.overlay"
      - "EXTRA_CONF_FILE=\
         ../../../../../tt-system-firmware/test-conf/tests/drivers/dma/chan_link_transfer/\
         arc_hs.conf"
```

## test-conf/tests/drivers/flash/common/testcase.yaml
```yaml
common:
  tags:
    - drivers
    - flash
tests:
  drivers.flash.common:
    tags: smoke
    platform_allow:
      - tt_blackhole@p100a/tt_blackhole/smc
      - tt_blackhole@p150a/tt_blackhole/smc
      - tt_blackhole@p300a/tt_blackhole/smc
    extra_args:
      - "platform:tt_blackhole@p100a/tt_blackhole/smc:DTC_OVERLAY_FILE=\
         ../../../../../tt-system-firmware/test-conf/tests/drivers/flash/\
         common/tt_blackhole_tt_blackhole_smc.overlay"
      - "platform:tt_blackhole@p100a/tt_blackhole/smc:EXTRA_CONF_FILE=\
         ../../../../../tt-system-firmware/test-conf/tests/drivers/flash/\
         common/tt_blackhole_tt_blackhole_smc.conf"
      - "platform:tt_blackhole@p150a/tt_blackhole/smc:DTC_OVERLAY_FILE=\
         ../../../../../tt-system-firmware/test-conf/tests/drivers/flash/\
         common/tt_blackhole_tt_blackhole_smc.overlay"
      - "platform:tt_blackhole@p150a/tt_blackhole/smc:EXTRA_CONF_FILE=\
         ../../../../../tt-system-firmware/test-conf/tests/drivers/flash/\
         common/tt_blackhole_tt_blackhole_smc.conf"
      - "platform:tt_blackhole@p300a/tt_blackhole/smc:DTC_OVERLAY_FILE=\
         ../../../../../tt-system-firmware/test-conf/tests/drivers/flash/\
         common/tt_blackhole_tt_blackhole_smc.overlay"
      - "platform:tt_blackhole@p300a/tt_blackhole/smc:EXTRA_CONF_FILE=\
         ../../../../../tt-system-firmware/test-conf/tests/drivers/flash/\
         common/tt_blackhole_tt_blackhole_smc.conf"
```

## test-conf/tests/drivers/gpio/gpio_api_1pin/testcase.yaml
```yaml
common:
  tags:
    - drivers
    - gpio
  depends_on: gpio
tests:
  drivers.gpio.1pin:
    tags: smoke
    platform_allow:
      - tt_blackhole@p100a/tt_blackhole/smc
      - tt_blackhole@p150a/tt_blackhole/smc
      - tt_blackhole@p150b/tt_blackhole/smc
      - tt_blackhole@p300a/tt_blackhole/smc
      - tt_blackhole@orion_slt/tt_blackhole/smc
      - tt_mimir/tt_mimir/smc
    extra_args:
      - "platform:tt_blackhole@p100a/tt_blackhole/smc:DTC_OVERLAY_FILE=\
         ../../../../../tt-system-firmware/test-conf/tests/drivers/gpio/gpio_api_1pin/\
         boards/tt_blackhole_tt_blackhole_smc.overlay"
      - "platform:tt_blackhole@p150a/tt_blackhole/smc:DTC_OVERLAY_FILE=\
         ../../../../../tt-system-firmware/test-conf/tests/drivers/gpio/gpio_api_1pin/\
         boards/tt_blackhole_tt_blackhole_smc.overlay"
      - "platform:tt_blackhole@p150b/tt_blackhole/smc:DTC_OVERLAY_FILE=\
         ../../../../../tt-system-firmware/test-conf/tests/drivers/gpio/gpio_api_1pin/\
         boards/tt_blackhole_tt_blackhole_smc.overlay"
      - "platform:tt_blackhole@p300a/tt_blackhole/smc:DTC_OVERLAY_FILE=\
         ../../../../../tt-system-firmware/test-conf/tests/drivers/gpio/gpio_api_1pin\
         boards/tt_blackhole_tt_blackhole_smc.overlay"
      - "platform:tt_blackhole@orion_slt/tt_blackhole/smc:DTC_OVERLAY_FILE=\
         ../../../../../tt-system-firmware/test-conf/tests/drivers/gpio/gpio_api_1pin/\
         boards/tt_blackhole_tt_blackhole_smc.overlay"
      - "platform:tt_mimir/tt_mimir/smc:DTC_OVERLAY_FILE=\
         ../../../../../tt-system-firmware/test-conf/tests/drivers/gpio/gpio_api_1pin/\
         boards/tt_mimir_tt_mimir_smc.overlay"
      - "platform:tt_mimir/tt_mimir/smc:CONF_FILE=\
         ../../../../../tt-system-firmware/test-conf/tests/drivers/gpio/gpio_api_1pin/\
         boards/tt_mimir_tt_mimir_smc.conf"
    harness_config:
      fixture: gpio_external_pull_down
```

## tests/boards/tenstorrent/tt_blackhole/bh_fwtable/testcase.yaml
```yaml
tests:
  drivers.misc.bh_fwtable:
    build_only: true
    tags:
      - smoke
    platform_allow:
      - tt_blackhole@p100a/tt_blackhole/smc
      - tt_blackhole@p150a/tt_blackhole/smc
      - tt_blackhole@p150b/tt_blackhole/smc
      - tt_blackhole@p300a/tt_blackhole/smc
```
