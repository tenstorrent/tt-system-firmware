## app/dmc_rom_update/sample.yaml
```yaml
sample:
  name: dmc-rom-update
tests:
  dmc-rom-update.app:
    platform_allow:
      - tt_blackhole@p100a/tt_blackhole/dmc
      - tt_blackhole@p150a/tt_blackhole/dmc
      - tt_blackhole@p300a/tt_blackhole/dmc
    # Runtime tests will be conducted wih the SMC firmware and tt-flash,
    # and this app will be pulled in via sysbuild.
    build_only: true
```

## drivers/Kconfig
```kconfig
#  Copyright (c) 2024 Tenstorrent AI ULC
#  SPDX-License-Identifier: Apache-2.0

menu "Device Drivers"

# zephyr-keep-sorted-start
rsource "clock_control/Kconfig"
rsource "console/Kconfig"
rsource "dma/Kconfig"
rsource "flash/Kconfig"
rsource "gpio/Kconfig"
rsource "jtag/Kconfig"
rsource "mbox/Kconfig"
rsource "mfd/Kconfig"
rsource "misc/Kconfig"
rsource "pmci/Kconfig"
rsource "pwm/Kconfig"
rsource "reset/Kconfig"
rsource "sensor/Kconfig"
rsource "serial/Kconfig"
rsource "smbus/target/Kconfig"
rsource "watchdog/Kconfig"
# zephyr-keep-sorted-stop

endmenu
```

## drivers/misc/Kconfig
```kconfig
# Copyright (c) 2025 Tenstorrent AI ULC
#
# SPDX-License-Identifier: Apache-2.0

# to match zephyr/drivers/misc/Kconfig
menu "Miscellaneous Drivers"

# zephyr-keep-sorted-start
rsource "bh_efuse/Kconfig"
rsource "bh_fwtable/Kconfig"
rsource "tt_smc_remoteproc/Kconfig"
# zephyr-keep-sorted-stop

endmenu
```

## drivers/misc/bh_efuse/Kconfig
```kconfig
# Copyright (c) 2026 Tenstorrent AI ULC
# SPDX-License-Identifier: Apache-2.0

config TT_BH_EFUSE
	bool "Tenstorrent Blackhole eFuse driver"
	default y
	depends on DT_HAS_TENSTORRENT_BH_EFUSE_ENABLED || DT_HAS_TENSTORRENT_BH_EFUSE_EMUL_ENABLED
	help
	  Enable the Tenstorrent Blackhole eFuse driver API.

if TT_BH_EFUSE

config TT_BH_EFUSE_INIT_PRIORITY
	int "Tenstorrent Blackhole eFuse init priority"
	default 80
	help
	  Set initialization priority for the eFuse driver.

config TT_BH_EFUSE_EMUL
	bool "Tenstorrent Blackhole eFuse emulation backend"
	default y
	depends on DT_HAS_TENSTORRENT_BH_EFUSE_EMUL_ENABLED
	help
	  Enable emulated eFuse backend where values are supplied by devicetree.

module = TT_BH_EFUSE
module-str = tt_bh_efuse
source "subsys/logging/Kconfig.template.log_config"

endif
```

## drivers/misc/bh_fwtable/Kconfig
```kconfig
# Copyright (c) 2025 Tenstorrent AI ULC
# SPDX-License-Identifier: Apache-2.0

config BH_FWTABLE
	bool "Tenstorrent Blackhole Firmware Table"
	default y
	depends on DT_HAS_TENSTORRENT_BH_FWTABLE_ENABLED && !TT_SMC_RECOVERY
	select TT_BOOT_FS
	help
		Enable the Tenstorrent Blackhole Firmware Table.

		Disabled in SMC recovery builds: recovery must not depend on
		reading the SPI firmware tables during bring-up, so it links the
		static chip-info backend (chip_info_static.c) instead of this
		driver. See lib/tenstorrent/bh_arc/chip_info.h.

if BH_FWTABLE

config BH_FWTABLE_INIT_PRIORITY
	int "Tenstorrent Blackhole firmware table init priority"
	default 90
	help
		Set the initialization priority for the Tenstorrent Blackhole firmware table.

		This priority should be selected so that bh_fwtable is initialized after the SPI EEPROM.

config BH_FWTABLE_CCFGOVR
	bool "Apply ccfgovr override of the cmfwcfg table"
	default y
	help
		Apply ccfgovr override of the cmfwcfg table.

module = BH_FWTABLE
module-str = bh_fwtable
source "subsys/logging/Kconfig.template.log_config"

endif
```

## drivers/sensor/tenstorrent/Kconfig
```kconfig
#  Copyright (c) 2025 Tenstorrent AI ULC
#  SPDX-License-Identifier: Apache-2.0

# zephyr-keep-sorted-start
rsource "bh_arc_telem/Kconfig"
rsource "pvt/Kconfig"
# zephyr-keep-sorted-stop
```

## drivers/sensor/tenstorrent/bh_arc_telem/Kconfig
```kconfig
#  Copyright (c) 2026 Tenstorrent AI ULC
#  SPDX-License-Identifier: Apache-2.0

config BH_ARC_TELEMETRY
	bool "Tenstorrent BH-arc live telemetry sensor"
	default y
	depends on DT_HAS_TENSTORRENT_BH_ARC_TELEMETRY_ENABLED
	depends on SMBUS
	help
	  Enable Zephyr sensor driver that reads live telemetry from a
	  tenstorrent,bh-arc (SMC) device node via SMBus.  Each sample issues a
	  byte-data write to CMFW_SMBUS_TELEMETRY_READ_CRC followed by a block
	  read from CMFW_SMBUS_TELEMETRY_READ_CRC_DATA.  Reads are served
	  through the RTIO submit API.  Channel-to-telemetry-tag mappings are defined in the
	  device tree.
```

## drivers/sensor/tenstorrent/pvt/Kconfig
```kconfig
# Copyright (c) 2025 Tenstorrent AI ULC
# SPDX-License-Identifier: Apache-2.0

config PVT_TT_BH
	bool "Tenstorrent Blackhole PVT driver"
	default y
	depends on DT_HAS_TENSTORRENT_BH_PVT_ENABLED
	help
		Enable the Tenstorrent Blackhole process, voltage and temperature driver.

config PVT_TT_BH_EMUL
	bool "Tenstorrent Blackhole PVT emulator driver"
	default y
	depends on DT_HAS_TENSTORRENT_BH_PVT_EMUL_ENABLED
	help
		Enable the emulated Tenstorrent Blackhole process, voltage and temperature driver.
```

## dts/bindings/misc/tenstorrent,bh-efuse-emul.yaml
```yaml
# Copyright (c) 2026 Tenstorrent AI ULC
# SPDX-License-Identifier: Apache-2.0

description: Tenstorrent Blackhole eFuse emulation backend

compatible: "tenstorrent,bh-efuse-emul"

include: base.yaml

properties:
  dft0-dwords:
    type: array
    description: |
      Optional sparse array of (offset, value) pairs for DFT0 efuse box reads.
      Each pair specifies a dword offset and its 32-bit value.
      Example: <50 0xDEADBEEF  51 0xCAFEBABE>

  dft1-dwords:
    type: array
    description: |
      Optional sparse array of (offset, value) pairs for DFT1 efuse box reads.
      Each pair specifies a dword offset and its 32-bit value.

  func-dwords:
    type: array
    description: |
      Optional sparse array of (offset, value) pairs for functional efuse box reads.
      Each pair specifies a dword offset and its 32-bit value.
      Example: <50 0xDEADBEEF> sets dword 50 (ASIC_ID_LOW) to 0xDEADBEEF.
```

## dts/bindings/misc/tenstorrent,bh-efuse.yaml
```yaml
# Copyright (c) 2026 Tenstorrent AI ULC
# SPDX-License-Identifier: Apache-2.0

description: Tenstorrent Blackhole eFuse hardware backend

compatible: "tenstorrent,bh-efuse"

include: base.yaml
```

## dts/bindings/misc/tenstorrent,pldm-numeric-sensor.yaml
```yaml
# Copyright (c) 2026 Tenstorrent AI ULC
# SPDX-License-Identifier: Apache-2.0

description: |
  Child node under a Tenstorrent PLDM PDR provider describing one
  numeric sensor exported via PLDM platform commands.

compatible: "tenstorrent,pldm-numeric-sensor"

include: base.yaml

properties:
  sensor:
    type: phandle
    required: true
    description: Referenced sensor device.

  channel-type:
    type: int
    required: true
    min: 0
    max: 255
    description: Sensor channel type (SENSOR_CHAN_* value).

  channel-index:
    type: int
    required: true
    min: 0
    max: 255
    description: Sensor channel index for multi-channel devices.

  sensor-id:
    type: int
    required: true
    min: 0
    max: 65535
    description: PLDM sensor ID for this channel.

  entity-type:
    type: int
    default: 135
    min: 0
    max: 65535
    description: PLDM entity type.

  entity-instance:
    type: int
    default: 1
    min: 0
    max: 65535
    description: PLDM entity instance.

  container-id:
    type: int
    default: 0
    min: 0
    max: 65535
    description: PLDM entity container ID.

  base-unit:
    type: int
    min: 0
    max: 255
    description: Optional explicit PLDM base unit.

  unit-modifier:
    type: int
    default: 0
    min: -128
    max: 127
    description: PLDM unit modifier.

  sensor-name:
    type: string
    description: Optional ASCII auxiliary sensor name. The driver encodes this
      value as UTF-16BE when building the PLDM auxiliary-names PDR.
```

## dts/bindings/misc/tenstorrent,pldm-pdr.yaml
```yaml
# Copyright (c) 2026 Tenstorrent AI ULC
# SPDX-License-Identifier: Apache-2.0

description: |
  Tenstorrent PLDM PDR provider node.
  Child nodes compatible with tenstorrent,pldm-numeric-sensor define sensors
  exported into the PLDM PDR repository.

compatible: "tenstorrent,pldm-pdr"

include: base.yaml
```

## dts/bindings/misc/tenstorrent,smc-remoteproc.yaml
```yaml
# Copyright (c) 2025 Tenstorrent AI ULC
# SPDX-License-Identifier: Apache-2.0

description: |
  Tenstorrent SMC remote processor

compatible: "tenstorrent,smc-remoteproc"

include: [i3c-device.yaml]

properties:
  boot-gpios:
    type: phandle-array
    description: |
      Optional GPIO used to signal when the remote processor ROM is ready.
      If omitted, the driver skips GPIO wait and does not perform an
      additional DAA during initialization.
```

## dts/bindings/pinctrl/tenstorrent,bh-pinctrl.yaml
```yaml
# Copyright (c) 2024 Tenstorrent AI ULC
# SPDX-License-Identifier: Apache-2.0

description: |
  Pin configuration for Tenstorrent Blackhole SoC.

compatible: "tenstorrent,bh-pinctrl"

include: base.yaml

properties: {}

child-binding:
  description: |
    This binding gives a base representation of Blackhole SoC pin configuration.

  include:
    - name: pincfg-node.yaml
      property-allowlist:
        - bias-disable
        - bias-pull-down
        - bias-pull-up
        - drive-strength
        - input-enable
        - receive-enable
        - input-schmitt-enable

  properties:
    pinmux:
      required: true
      type: array
      description: |
        Blackhole pin configuration (IO pin, IO function).

    drive-strength:
      type: int
      default: 127
      description: |
        Drive strength of the pin (8-bit field, 0-255).
```

## dts/bindings/sensor/tenstorrent,bh-arc-telemetry.yaml
```yaml
# Copyright (c) 2026 Tenstorrent AI ULC
# SPDX-License-Identifier: Apache-2.0

description: |
  Zephyr sensor driver that performs a live telemetry read from a
  tenstorrent,bh-arc device (the SMC/ARC on a BH chip).

  Configuration is one provider node per SMC and one or more
  child channel mapping nodes that translate (channel-type, channel-index)
  to a telemetry tag.

  Each fetch issues a two-step CRC-framed telemetry read: it writes the
  mapped telemetry tag index to CMFW_SMBUS_TELEMETRY_READ_CRC, then reads the
  7-byte response from CMFW_SMBUS_TELEMETRY_READ_CRC_DATA. The payload value is
  decoded from bytes 3 through 6 of that response.

compatible: "tenstorrent,bh-arc-telemetry"

include: [sensor-device.yaml, base.yaml]

properties:
  arc:
    type: phandle
    required: true
    description: |
      Phandle to a tenstorrent,bh-arc SMBus device node.  The driver reads
      the SMBus bus and address from this node at compile time.

child-binding:
  description: Channel mapping entry for a tenstorrent,bh-arc-telemetry provider
  properties:
    channel-type:
      type: int
      required: true
      description: Zephyr sensor_channel enum value

    channel-index:
      type: int
      default: 0
      description: Channel index within channel-type

    telemetry-tag:
      type: int
      required: true
      description: TAG_* value requested from SMC telemetry

    scale-micro:
      type: int
      default: 1000000
      description: Scale factor in micro physical-units per raw LSB
```

## dts/bindings/sensor/tenstorrent,bh-pvt-emul.yaml
```yaml
# Copyright (c) 2026 Tenstorrent AI ULC
# SPDX-License-Identifier: Apache-2.0

description: Tenstorrent Blackhole PVT emulator

compatible: "tenstorrent,bh-pvt-emul"

include: [sensor-device.yaml, base.yaml]

properties:
  num_pd:
    type: int
    required: true

  num_vm:
    type: int
    required: true

  num_ts:
    type: int
    required: true

  pd-raw:
    type: int
    default: 15300
    min: 0
    max: 65535
    description: Raw PD sample returned for all PD channels.

  vm-raw:
    type: int
    default: 11795
    min: 0
    max: 65535
    description: Raw VM sample returned for all VM channels.

  ts-raw:
    type: int
    default: 1742
    min: 0
    max: 65535
    description: Raw TS sample returned for all TS channels and TS average.
```

## lib/tenstorrent/bh_arc/Kconfig
```kconfig
# Copyright (c) 2024 Tenstorrent AI ULC
# SPDX-License-Identifier: Apache-2.0

config TT_BH_ARC
	bool "Blackhole ARC firmware library"
	select FLASH
	select FLASH_PAGE_LAYOUT
	select TT_BOOT_FS
	select NANOPB
	select CRC
	select I2C
	select I2C_TARGET
	select SMBUS_TARGET
	select ZBUS
	help
	  This option enables the Blackhole ARC firmware library.

if TT_BH_ARC

config TT_BH_ARC_EMUL
	bool "BH ARC emulation"
	default y if BOARD_NATIVE_SIM
	help
	  Generic flag that BH ARC is emulated.
	  Enabled by default on native_sim and can be enabled on other
	  boards that need emulated ARC behavior.

config TT_BH_ARC_NUM_MSG_CODES
	int "Number of message codes"
	default 200
	help
	  The number of message codes

config TT_BH_ARC_MSGQUEUE_ENABLED
	bool "Enable BH ARC message queue"
	default y
	help
	  Enable initialization and implementation of the BH ARC message queue.

config TT_SHELL
	bool "Tenstorrent Blackhole shell driver"
	depends on SHELL
	default y
	help
	  Enable the Tenstorrent Shell

config TT_BH_ARC_FAN_CTRL_ALPHA
	int "Fan control alpha value"
	default 50
	help
	  Value of alpha for filtering fan curve input temp

config TT_BH_ARC_FAN_CTRL_GDDR_TEMP
	bool "Use GDDR temp as fan curve input"
	default y
	help
	  Enable to use GDDR temp in fan speed calculation

config TT_BH_ARC_I2C_TIMEOUT
	bool "Time out if I2C transaction exceeds given duration"
	default y
	help
	  Timeout if I2C transaction exceeds set duration. This can be useful
	  to recover from bus stalls. If the TX FIFO for the I2C controller
	  remains full for this timeout, the I2C controller will attempt to
	  recover the bus by sending 16 SCL pulses while holding SDA low.

config TT_BH_ARC_I2C_TIMEOUT_DURATION
	int "Timeout for I2C transactions in milliseconds"
	default 25
	depends on TT_BH_ARC_I2C_TIMEOUT
	help
	  Timeout for I2C transactions in milliseconds. If the TX FIFO for the I2C controller
	  remains full for this timeout, the I2C controller will attempt to recover the bus by
	  sending 16 SCL pulses while holding SDA low.

config TT_SMC_RECOVERY
	bool "build smc recovery image"
	help
	  Enable to build smc recovery image.

config TT_BH_ARC_WDT_FEED_INTERVAL
	int "Feed interval for watchdog (ms)"
	default 250
	help
	  Interval to feed watchdog within firmware

config TT_BH_ARC_SCRATCHPAD_SIZE
	int "Size of scratchpad memory in bytes"
	default 512
	help
	  Size of scratchpad memory in bytes. This is mainly used as a temporary buffer for
	  loading images from SPI flash.

config TT_BH_ARC_RUNTIME_TELEMETRY_SIZE
	int "Runtime telemetry reserved BSS size in bytes"
	default 1024
	range 0 65536
	help
	  Bytes carved from BSS for host runtime telemetry use. Must be a multiple
	  of 32. Set to 0 to disable runtime telemetry.

config TT_BH_ARC_RUNTIME_TELEMETRY
	def_bool TT_BH_ARC_RUNTIME_TELEMETRY_SIZE > 0

config TT_BH_ARC_DMFW_PING_TIMEOUT
	int "Timeout for DMFW ping in milliseconds"
	default 200
	help
	  Timeout for DMFW ping in milliseconds. If the DMFW does not respond within this time,
	  the ping will be considered failed.

module = BH_ARC
module-str = bh_arc
source "subsys/logging/Kconfig.template.log_config"

rsource "Kconfig.tt_pcie_log"

endif
```

## lib/tenstorrent/bh_arc/Kconfig.tt_pcie_log
```kconfig
# Copyright (c) 2026 Tenstorrent AI ULC
# SPDX-License-Identifier: Apache-2.0

if LOG

config TT_PCIE_LOG_BACKEND
	bool "Enable Tenstorrent Host tt_pcie_log backend"
	depends on !LOG_MODE_IMMEDIATE
	select LOG_OUTPUT
	help
	  Enable tt_pcie_log backend that outputs logs to shared host memory buffer
	  via DMA for kernel module consumption. When host is not available,
	  logs are stored in local buffer and transferred when host connects.

if TT_PCIE_LOG_BACKEND

config TT_PCIE_LOG_BACKEND_BUFFER_SIZE
	int "Local log buffer size in bytes"
	default 4096
	help
	  Size of local buffer to aggregate logs into. Logs from this buffer
	  are flushed on a timer, or when approaching capacity, and only if the
	  host has messaged FW the buffer is available.

endif # TT_PCIE_LOG_BACKEND

endif # LOG
```
