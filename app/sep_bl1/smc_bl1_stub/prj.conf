## CMakeLists.txt
```
# SPDX-License-Identifier: Apache-2.0

cmake_minimum_required(VERSION 3.13.1)
find_package(Zephyr REQUIRED HINTS $ENV{ZEPHYR_BASE})

project(smc_bl1_stub LANGUAGES C)

target_sources(app PRIVATE src/main.c)
```

## prj.conf
```kconfig
# Copyright (c) 2026 Tenstorrent AI ULC
# SPDX-License-Identifier: Apache-2.0

# Stand-in for SMC BL1 in the SEP BL1 handoff test. It only has to prove that
# BL0P5 copied it to load_addr and mret'd to entry_point, so everything the
# real BL1 would bring up is off.
CONFIG_I3C=n
CONFIG_SENSOR=n
CONFIG_FLASH=n
CONFIG_CBPRINTF_FP_SUPPORT=n
CONFIG_PICOLIBC_IO_LONG_LONG=n

CONFIG_ISR_STACK_SIZE=512
CONFIG_IDLE_STACK_SIZE=256
CONFIG_MP_MAX_NUM_CPUS=1
```

## boards/tt_mmk_tt_keraunos_smc.overlay
```dts
/*
 * Copyright (c) 2026 Tenstorrent AI ULC
 *
 * SPDX-License-Identifier: Apache-2.0
 */

/* Linked clear of both the BUN2 staging area (0xc0066400 + 0x20000, ending at
 * 0xc0086400) and BL0P5 itself (0xc0150000 + 0xc000), so a staged bundle and
 * its own execute location never overlap. Must match the load_addr the test
 * puts in the BUN2 TOC entry.
 */
&ram0 {
	reg = <0x0 0xc0090000 0x0 0x20000>;
};

/* Not used by the stub; disables the remoteproc driver and the I3C bus it needs */
&remoteproc {
	status = "disabled";
};

&i3c1 {
	status = "disabled";
};
```

## src/main.c
```c
/*
 * Copyright (c) 2026 Tenstorrent AI ULC
 * SPDX-License-Identifier: Apache-2.0
 *
 * Stand-in for SMC BL1 in the SEP BL1 handoff test. It is the TOC[0] image of
 * the staged BUN2, so reaching main() proves the whole chain ran: the SEP-side
 * driver staged the bundle, SMC BL0P5 got its validation ACK, copied this
 * image to load_addr, and mret'd to entry_point.
 *
 * The PASS code lands in SMC scratch[0].
 */

#include <zephyr/kernel.h>
#include <zephyr/sys/printk.h>

#include <soc.h>

int main(void)
{
	printk("SMC BL1 stub: reached via BL0P5 handoff\n");
	test_pass();

	/* BL1 owns the core from here on; returning would panic BL0P5's caller. */
	for (;;) {
		k_cpu_idle();
	}

	return 0;
}
```
