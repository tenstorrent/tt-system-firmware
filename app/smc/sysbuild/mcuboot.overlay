/*
 * Copyright (c) 2025 Tenstorrent AI ULC
 *
 * SPDX-License-Identifier: Apache-2.0
 */

#include "../boards/tt_blackhole_smc_partitions.dtsi"

/ {
	chosen {
		zephyr,sram = &csm_bootloader;
		mcuboot,image-ram = &csm_app;
	};
};
