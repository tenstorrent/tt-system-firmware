/*
 * Copyright (c) 2025 Tenstorrent AI ULC
 * SPDX-License-Identifier: Apache-2.0
 */

#include <mem.h>

storage_partition: &storage {
	reg = <0x500000 DT_SIZE_K(64)>;
};

&vuart0 {
	/* to avoid drivers.flash.common failing due to buffer size being too small */
	rx-cap = <1024>;
	tx-cap = <(3036 + 4096)>;
};

/* Raise CSM to 320KB: this test does not fit in the 256KB board default */
&csm {
	reg = <0x10000000 0x50000>;
};
