/*
 * Copyright (c) 2025 Tenstorrent AI ULC
 * SPDX-License-Identifier: Apache-2.0
 */

tst_dma0: &dma0 {
	status = "okay";
	dma-buf-addr-alignment = <32>;
	/delete-property/ interrupts;
	/delete-property/ interrupt-parent;
};
