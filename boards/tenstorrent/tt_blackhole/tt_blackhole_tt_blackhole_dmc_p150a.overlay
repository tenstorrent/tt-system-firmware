/*
 * Copyright (c) 2026 Tenstorrent AI ULC
 *
 * SPDX-License-Identifier: Apache-2.0
 */

/ {
	/*
	 * MCU_CONN_I2C_EN (PD2) is OE for FXMA2102 U1, which joins the QSFP-DD
	 * cages to MCU_I2C0. That net is the DMC's i2c3 (STM_I2C3 through the
	 * stuffed R4334/R4335) and ASIC ball D32/BP_I2C. The STM_I2C2 path to
	 * MCU_I2C0 (R4324/R4325) is not stuffed on P150A.
	 *
	 * Other revisions use PD2 for unrelated signals (JTAG TDO on P100,
	 * an ARC JTAG mux select on Orion SLT), so keep this P150A only.
	 */
	qsfp_i2c_en: qsfp-i2c-en {
		compatible = "zephyr,gpio-line";
		gpios = <&gpiod 2 GPIO_ACTIVE_HIGH>;
	};
};

&gpiod {
	qsfp-i2c-en-hog {
		gpio-hog;
		gpios = <2 GPIO_ACTIVE_HIGH>;
		output-low;
		line-name = "qsfp-i2c-enable";
	};
};
