/*
 * Copyright (c) 2024 Tenstorrent AI ULC
 *
 * SPDX-License-Identifier: Apache-2.0
 */

/dts-v1/;

#include <tenstorrent/tt_grendel_smc.dtsi>
#include <tenstorrent/tt_mimir_d2d.dtsi>
#include <tenstorrent/tt_mimir_gddr.dtsi>

/ {
	chosen {
		zephyr,sram = &ram0;
	};
};

&{/soc} {
	/* Cold Scratch 4 */
	telemetry_info: scratch-reg@c0002810 {
		compatible = "tenstorrent,scratch-reg";
		reg = <0x0 0xc0002810 0x0 0x4>;
		status = "okay";
	};
};
